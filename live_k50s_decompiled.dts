/dts-v1/;

/ {
	eth_order = "0001:11:00.0,0002:21:00.0,0000:01:00.0,fe010000.ethernet,fe2a0000.ethernet";
	kdebug = "0";
	#address-cells = <0x02>;
	hw_support = "hdmi,2.5g";
	model = "ROCEOS K50S";
	#size-cells = <0x02>;
	is_testing = "1";
	interrupt-parent = <0x01>;
	compatible = "roceos,k50s\0rockchip,rk3568\0gmac_1v8";
	eth_driver = "r8125";
	hwmodel_id = "K50S";
	modified_time = "2024/08/02 11:02:10";

	pcie30-avdd1v8 {
		regulator-max-microvolt = <0x1b7740>;
		regulator-boot-on;
		regulator-always-on;
		regulator-min-microvolt = <0x1b7740>;
		regulator-name = "pcie30_avdd1v8";
		compatible = "regulator-fixed";
		vin-supply = <0x37>;
	};

	nocp-cpu@fe102000 {
		compatible = "rockchip,rk3568-nocp";
		reg = <0x00 0xfe102000 0x00 0x400>;
		phandle = <0xa3>;
	};

	pdm-mic-array {
		simple-audio-card,name = "rockchip,pdm-mic-array";
		compatible = "simple-audio-card";
		status = "disabled";

		simple-audio-card,cpu {
			sound-dai = <0x121>;
		};

		simple-audio-card,codec {
			sound-dai = <0x122>;
		};
	};

	spi@fe620000 {
		pinctrl-names = "default\0high_speed";
		#address-cells = <0x01>;
		num-cs = <0x02>;
		pinctrl-0 = <0xe1 0xe2 0xe3>;
		clock-names = "spiclk\0apb_pclk";
		interrupts = <0x00 0x68 0x04>;
		clocks = <0x20 0x154 0x20 0x153>;
		#size-cells = <0x00>;
		dma-names = "tx\0rx";
		compatible = "rockchip,rk3066-spi";
		pinctrl-1 = <0xe1 0xe2 0xe4>;
		status = "disabled";
		reg = <0x00 0xfe620000 0x00 0x1000>;
		dmas = <0x40 0x16 0x40 0x17>;
	};

	wireless-bluetooth {
		pinctrl-names = "default\0rts_gpio";
		pinctrl-0 = <0x12e>;
		clock-names = "ext_clock";
		clocks = <0x12b 0x01>;
		BT,wake_gpio = <0x38 0x1d 0x00>;
		BT,reset_gpio = <0x130 0x14 0x00>;
		uart_rts_gpios = <0x82 0x09 0x01>;
		compatible = "bluetooth-platdata";
		BT,wake_host_irq = <0x38 0x1c 0x00>;
		pinctrl-1 = <0x12f>;
		status = "okay";
	};

	i2s3-mclkin {
		clock-output-names = "i2s3_mclkin";
		#clock-cells = <0x00>;
		clock-frequency = <0xbb8000>;
		compatible = "fixed-clock";
	};

	qos@fe158300 {
		compatible = "syscon";
		reg = <0x00 0xfe158300 0x00 0x20>;
		phandle = <0x53>;
	};

	iommu@fdf80800 {
		power-domains = <0x22 0x0d>;
		clock-names = "aclk\0iface";
		interrupts = <0x00 0x5c 0x04>;
		clocks = <0x20 0x108 0x20 0x109>;
		#iommu-cells = <0x00>;
		compatible = "rockchip,iommu-v2";
		status = "okay";
		interrupt-names = "rkvdec_mmu";
		reg = <0x00 0xfdf80800 0x00 0x40 0x00 0xfdf80840 0x00 0x40>;
		phandle = <0x75>;
	};

	scmi-shmem@10f000 {
		compatible = "arm,scmi-shmem";
		reg = <0x00 0x10f000 0x00 0x100>;
		phandle = <0x1b>;
	};

	syscon@fdc20000 {
		compatible = "rockchip,rk3568-pmugrf\0syscon\0simple-mfd";
		reg = <0x00 0xfdc20000 0x00 0x10000>;
		phandle = <0x35>;

		reboot-mode {
			mode-normal = <0x5242c300>;
			mode-loader = <0x5242c301>;
			mode-bootloader = <0x5242c301>;
			mode-recovery = <0x5242c303>;
			mode-watchdog = <0x5242c308>;
			mode-ums = <0x5242c30c>;
			mode-fastboot = <0x5242c309>;
			offset = <0x200>;
			compatible = "syscon-reboot-mode";
			mode-charge = <0x5242c30b>;
			mode-panic = <0x5242c307>;
		};

		io-domains {
			vccio1-supply = <0x2c>;
			vccio3-supply = <0x2d>;
			vccio4-supply = <0x2e>;
			vccio5-supply = <0x2f>;
			pmuio2-supply = <0x2b>;
			vccio6-supply = <0x2e>;
			vccio7-supply = <0x2f>;
			compatible = "rockchip,rk3568-pmu-io-voltage-domain";
			status = "okay";
		};
	};

	i2c@fe5c0000 {
		pinctrl-names = "default";
		#address-cells = <0x01>;
		pinctrl-0 = <0xda>;
		clock-names = "i2c\0pclk";
		interrupts = <0x00 0x31 0x04>;
		clocks = <0x20 0x14c 0x20 0x14b>;
		#size-cells = <0x00>;
		compatible = "rockchip,rk3399-i2c";
		status = "disabled";
		reg = <0x00 0xfe5c0000 0x00 0x1000>;
	};

	iep@fdef0000 {
		power-domains = <0x22 0x0a>;
		iommus = <0x71>;
		clock-names = "aclk\0hclk\0sclk";
		resets = <0x20 0x127 0x20 0x128 0x20 0x129>;
		interrupts = <0x00 0x38 0x04>;
		clocks = <0x20 0xf6 0x20 0xf7 0x20 0xf8>;
		rockchip,srv = <0x6d>;
		rockchip,taskqueue-node = <0x05>;
		compatible = "rockchip,iep-v2";
		rockchip,resetgroup-node = <0x05>;
		status = "okay";
		reg = <0x00 0xfdef0000 0x00 0x500>;
		reset-names = "rst_a\0rst_h\0rst_s";
	};

	gpu@fde60000 {
		power-domains = <0x22 0x07>;
		downdifferential = <0x0a>;
		mali-supply = <0x69>;
		clock-names = "clk_mali\0clk_gpu";
		interrupts = <0x00 0x27 0x04 0x00 0x29 0x04 0x00 0x28 0x04>;
		clocks = <0x02 0x01 0x20 0x1b>;
		upthreshold = <0x28>;
		power-off-delay-ms = <0xc8>;
		compatible = "arm,mali-bifrost";
		status = "okay";
		interrupt-names = "GPU\0MMU\0JOB";
		reg = <0x00 0xfde60000 0x00 0x4000>;
		phandle = <0x1e>;
		operating-points-v2 = <0x68>;
		#cooling-cells = <0x02>;

		power-model {
			thermal-zone = "gpu-thermal";
			ls = <0xffffa23e 0x5927 0x00>;
			dynamic-coefficient = <0x3b9>;
			compatible = "simple-power-model";
			ts = <0xfffe56a6 0xf87a 0xfffffab5 0x14>;
			static-coefficient = <0x186a0>;
			leakage-range = <0x05 0x0f>;
		};
	};

	spdif@fe460000 {
		pinctrl-names = "default";
		pinctrl-0 = <0xd5>;
		clock-names = "mclk\0hclk";
		interrupts = <0x00 0x66 0x04>;
		clocks = <0x20 0x5f 0x20 0x5c>;
		dma-names = "tx";
		#sound-dai-cells = <0x00>;
		compatible = "rockchip,rk3568-spdif";
		status = "disabled";
		reg = <0x00 0xfe460000 0x00 0x1000>;
		phandle = <0x124>;
		dmas = <0xc1 0x01>;
	};

	qos@fe1a8100 {
		compatible = "syscon";
		reg = <0x00 0xfe1a8100 0x00 0x20>;
		phandle = <0x4d>;
	};

	vcc3v3-pcie {
		regulator-max-microvolt = <0x325aa0>;
		gpio = <0x38 0x14 0x00>;
		enable-active-high;
		regulator-min-microvolt = <0x325aa0>;
		regulator-name = "vcc3v3_pcie";
		startup-delay-us = <0x1388>;
		compatible = "regulator-fixed";
		phandle = <0xad>;
		vin-supply = <0x128>;
	};

	syscon@fdc60000 {
		compatible = "rockchip,rk3568-grf\0syscon\0simple-mfd";
		reg = <0x00 0xfdc60000 0x00 0x10000>;
		phandle = <0x34>;

		lvds {
			phy-names = "phy";
			compatible = "rockchip,rk3568-lvds";
			status = "disabled";
			phys = <0x30>;

			ports {
				#address-cells = <0x01>;
				#size-cells = <0x00>;

				port@0 {
					#address-cells = <0x01>;
					#size-cells = <0x00>;
					reg = <0x00>;

					endpoint@1 {
						remote-endpoint = <0x19>;
						status = "disabled";
						reg = <0x01>;
						phandle = <0x92>;
					};

					endpoint@2 {
						remote-endpoint = <0x31>;
						status = "disabled";
						reg = <0x02>;
						phandle = <0x93>;
					};
				};
			};
		};

		rgb {
			pinctrl-names = "default";
			pinctrl-0 = <0x32>;
			compatible = "rockchip,rk3568-rgb";
			status = "disabled";

			ports {
				#address-cells = <0x01>;
				#size-cells = <0x00>;

				port@0 {
					#address-cells = <0x01>;
					#size-cells = <0x00>;
					reg = <0x00>;

					endpoint@2 {
						remote-endpoint = <0x1a>;
						status = "disabled";
						reg = <0x02>;
						phandle = <0x94>;
					};
				};
			};
		};

		io-domains {
			compatible = "rockchip,rk3568-io-voltage-domain";
			status = "disabled";
		};
	};

	pinctrl {
		#address-cells = <0x02>;
		#size-cells = <0x02>;
		compatible = "rockchip,rk3568-pinctrl";
		rockchip,pmu = <0x35>;
		ranges;
		rockchip,grf = <0x34>;

		eth0 {
		};

		i2c3 {

			i2c3m0-xfer {
				rockchip,pins = <0x01 0x01 0x01 0x119 0x01 0x00 0x01 0x119>;
				phandle = <0xda>;
			};
		};

		pwm9 {

			pwm9m0-pins {
				rockchip,pins = <0x03 0x0a 0x05 0x114>;
				phandle = <0xfb>;
			};
		};

		pwm14 {

			pwm14m0-pins {
				rockchip,pins = <0x03 0x14 0x01 0x114>;
				phandle = <0x100>;
			};
		};

		npu {
		};

		wireless-bluetooth {

			uart8-gpios {
				rockchip,pins = <0x02 0x09 0x00 0x114>;
				phandle = <0x12f>;
			};
		};

		pcie30x1 {
		};

		uart8 {

			uart8m0-rtsn {
				rockchip,pins = <0x02 0x09 0x03 0x114>;
				phandle = <0x12e>;
			};

			uart8m0-xfer {
				rockchip,pins = <0x02 0x16 0x02 0x116 0x02 0x15 0x03 0x116>;
				phandle = <0xf4>;
			};
		};

		gmac-txc-level2 {
		};

		spi2 {

			spi2m0-cs1 {
				rockchip,pins = <0x02 0x15 0x04 0x114>;
				phandle = <0xe6>;
			};

			spi2m0-cs0 {
				rockchip,pins = <0x02 0x14 0x04 0x114>;
				phandle = <0xe5>;
			};

			spi2m0-pins {
				rockchip,pins = <0x02 0x11 0x04 0x114 0x02 0x12 0x04 0x114 0x02 0x13 0x04 0x114>;
				phandle = <0xe7>;
			};
		};

		pcfg-pull-up-drv-level-2 {
			drive-strength = <0x02>;
			phandle = <0x115>;
			bias-pull-up;
		};

		i2s1 {

			i2s1m0-lrcktx {
				rockchip,pins = <0x01 0x05 0x01 0x114>;
				phandle = <0xc3>;
			};

			i2s1m0-mclk {
				rockchip,pins = <0x01 0x02 0x01 0x114>;
				phandle = <0x3f>;
			};

			i2s1m0-sclktx {
				rockchip,pins = <0x01 0x03 0x01 0x114>;
				phandle = <0xc2>;
			};

			i2s1m0-sdo0 {
				rockchip,pins = <0x01 0x07 0x01 0x114>;
				phandle = <0xc5>;
			};

			i2s1m0-sdi0 {
				rockchip,pins = <0x01 0x0b 0x01 0x114>;
				phandle = <0xc4>;
			};
		};

		pdm {

			pdmm0-sdi3 {
				rockchip,pins = <0x01 0x08 0x03 0x114>;
				phandle = <0xd3>;
			};

			pdmm0-sdi1 {
				rockchip,pins = <0x01 0x0a 0x03 0x114>;
				phandle = <0xd1>;
			};

			pdmm0-clk1 {
				rockchip,pins = <0x01 0x04 0x03 0x114>;
				phandle = <0xcf>;
			};

			pdmm0-sdi2 {
				rockchip,pins = <0x01 0x09 0x03 0x114>;
				phandle = <0xd2>;
			};

			pdmm0-sdi0 {
				rockchip,pins = <0x01 0x0b 0x02 0x114>;
				phandle = <0xd0>;
			};

			pdmm0-clk {
				rockchip,pins = <0x01 0x06 0x03 0x114>;
				phandle = <0xce>;
			};
		};

		i2c1 {

			i2c1-xfer {
				rockchip,pins = <0x00 0x0b 0x01 0x119 0x00 0x0c 0x01 0x119>;
				phandle = <0xd8>;
			};
		};

		pwm7 {

			pwm7-pins {
				rockchip,pins = <0x00 0x16 0x01 0x114>;
				phandle = <0xf9>;
			};
		};

		gmac0 {

			gmac0-miim {
				rockchip,pins = <0x02 0x13 0x02 0x114 0x02 0x14 0x02 0x114>;
				phandle = <0xb6>;
			};

			gmac0-tx-bus2 {
				rockchip,pins = <0x02 0x0b 0x01 0x117 0x02 0x0c 0x01 0x117 0x02 0x0d 0x01 0x114>;
				phandle = <0xb7>;
			};

			gmac0-rgmii-bus {
				rockchip,pins = <0x02 0x03 0x02 0x114 0x02 0x04 0x02 0x114 0x02 0x06 0x02 0x117 0x02 0x07 0x02 0x117>;
				phandle = <0xba>;
			};

			gmac0-rx-bus2 {
				rockchip,pins = <0x02 0x0e 0x01 0x114 0x02 0x0f 0x02 0x114 0x02 0x10 0x02 0x114>;
				phandle = <0xb8>;
			};

			gmac0-rgmii-clk {
				rockchip,pins = <0x02 0x05 0x02 0x114 0x02 0x08 0x02 0x118>;
				phandle = <0xb9>;
			};
		};

		pwm12 {

			pwm12m0-pins {
				rockchip,pins = <0x03 0x0f 0x02 0x114>;
				phandle = <0xfe>;
			};
		};

		uart6 {

			uart6m0-xfer {
				rockchip,pins = <0x02 0x03 0x03 0x116 0x02 0x04 0x03 0x116>;
				phandle = <0xf2>;
			};
		};

		gpu {
		};

		spi0 {

			spi0m0-cs0 {
				rockchip,pins = <0x00 0x16 0x02 0x114>;
				phandle = <0xdd>;
			};

			spi0m0-cs1 {
				rockchip,pins = <0x00 0x14 0x02 0x114>;
				phandle = <0xde>;
			};

			spi0m0-pins {
				rockchip,pins = <0x00 0x0d 0x02 0x114 0x00 0x15 0x02 0x114 0x00 0x0e 0x02 0x114>;
				phandle = <0xdf>;
			};
		};

		fspi {
		};

		clk32k {

			clk32k-out0 {
				rockchip,pins = <0x00 0x08 0x02 0x114>;
				phandle = <0x1f>;
			};
		};

		ebc {

			ebc-pins {
				rockchip,pins = <0x04 0x10 0x02 0x114 0x04 0x0b 0x02 0x114 0x04 0x0c 0x02 0x114 0x04 0x06 0x02 0x114 0x04 0x11 0x02 0x114 0x03 0x16 0x02 0x114 0x03 0x17 0x02 0x114 0x03 0x18 0x02 0x114 0x03 0x19 0x02 0x114 0x03 0x1a 0x02 0x114 0x03 0x1b 0x02 0x114 0x03 0x1c 0x02 0x114 0x03 0x1d 0x02 0x114 0x03 0x1e 0x02 0x114 0x03 0x1f 0x02 0x114 0x04 0x00 0x02 0x114 0x04 0x01 0x02 0x114 0x04 0x02 0x02 0x114 0x04 0x03 0x02 0x114 0x04 0x04 0x02 0x114 0x04 0x05 0x02 0x114 0x04 0x0e 0x02 0x114 0x04 0x0f 0x02 0x114>;
				phandle = <0x6e>;
			};
		};

		spi2-hs {

			spi2m0-pins {
				rockchip,pins = <0x02 0x11 0x04 0x11b 0x02 0x12 0x04 0x11b 0x02 0x13 0x04 0x11b>;
				phandle = <0xe8>;
			};
		};

		pwm5 {

			pwm5-pins {
				rockchip,pins = <0x00 0x14 0x01 0x114>;
				phandle = <0xf7>;
			};
		};

		pcfg-pull-none-drv-level-3 {
			drive-strength = <0x03>;
			bias-disable;
			phandle = <0x11c>;
		};

		isp {
		};

		pwm10 {

			pwm10m0-pins {
				rockchip,pins = <0x03 0x0d 0x05 0x114>;
				phandle = <0xfc>;
			};
		};

		pcfg-pull-down {
			bias-pull-down;
			phandle = <0x11d>;
		};

		uart4 {

			uart4m0-xfer {
				rockchip,pins = <0x01 0x04 0x02 0x116 0x01 0x06 0x02 0x116>;
				phandle = <0xf0>;
			};
		};

		mcu {
		};

		pwm3 {

			pwm3-pins {
				rockchip,pins = <0x00 0x12 0x01 0x114>;
				phandle = <0x45>;
			};
		};

		pcfg-pull-none-drv-level-1 {
			drive-strength = <0x01>;
			bias-disable;
			phandle = <0x118>;
		};

		sata2 {
		};

		cam {
		};

		uart2 {

			uart2m0-xfer {
				rockchip,pins = <0x00 0x18 0x01 0x116 0x00 0x19 0x01 0x116>;
				phandle = <0xee>;
			};
		};

		lcdc {

			lcdc-ctl {
				rockchip,pins = <0x03 0x00 0x01 0x114 0x02 0x18 0x01 0x114 0x02 0x19 0x01 0x114 0x02 0x1a 0x01 0x114 0x02 0x1b 0x01 0x114 0x02 0x1c 0x01 0x114 0x02 0x1d 0x01 0x114 0x02 0x1e 0x01 0x114 0x02 0x1f 0x01 0x114 0x03 0x01 0x01 0x114 0x03 0x02 0x01 0x114 0x03 0x03 0x01 0x114 0x03 0x04 0x01 0x114 0x03 0x05 0x01 0x114 0x03 0x06 0x01 0x114 0x03 0x07 0x01 0x114 0x03 0x08 0x01 0x114 0x03 0x09 0x01 0x114 0x03 0x0a 0x01 0x114 0x03 0x0b 0x01 0x114 0x03 0x0c 0x01 0x114 0x03 0x0d 0x01 0x114 0x03 0x0e 0x01 0x114 0x03 0x0f 0x01 0x114 0x03 0x10 0x01 0x114 0x03 0x13 0x01 0x114 0x03 0x11 0x01 0x114 0x03 0x12 0x01 0x114>;
				phandle = <0x32>;
			};
		};

		cpu {
		};

		gpio-func {

			tsadc-gpio-func {
				rockchip,pins = <0x00 0x01 0x00 0x114>;
				phandle = <0x104>;
			};
		};

		gpio4@fe770000 {
			gpio-controller;
			interrupts = <0x00 0x25 0x04>;
			clocks = <0x20 0x169 0x20 0x16a>;
			compatible = "rockchip,gpio-bank";
			#interrupt-cells = <0x02>;
			reg = <0x00 0xfe770000 0x00 0x100>;
			phandle = <0x130>;
			#gpio-cells = <0x02>;
			interrupt-controller;
		};

		sdmmc1 {
		};

		leds {

			led-green-en {
				rockchip,pins = <0x03 0x08 0x00 0x114>;
				phandle = <0x131>;
			};
		};

		pwm1 {

			pwm1m0-pins {
				rockchip,pins = <0x00 0x10 0x01 0x114>;
				phandle = <0x43>;
			};
		};

		sata0 {
		};

		refclk {
		};

		can2 {
		};

		sata {
		};

		audiopwm {
		};

		edpdp {
		};

		tsadc {

			tsadc-shutorg {
				rockchip,pins = <0x00 0x01 0x02 0x114>;
				phandle = <0x105>;
			};
		};

		gpio2@fe750000 {
			gpio-controller;
			interrupts = <0x00 0x23 0x04>;
			clocks = <0x20 0x165 0x20 0x166>;
			compatible = "rockchip,gpio-bank";
			#interrupt-cells = <0x02>;
			reg = <0x00 0xfe750000 0x00 0x100>;
			phandle = <0x82>;
			#gpio-cells = <0x02>;
			interrupt-controller;
		};

		uart0 {

			uart0-xfer {
				rockchip,pins = <0x00 0x10 0x03 0x116 0x00 0x11 0x03 0x116>;
				phandle = <0x41>;
			};
		};

		eth1 {
		};

		i2c4 {

			i2c4m0-xfer {
				rockchip,pins = <0x04 0x0b 0x01 0x119 0x04 0x0a 0x01 0x119>;
				phandle = <0xdb>;
			};
		};

		gpio0@fdd60000 {
			gpio-controller;
			interrupts = <0x00 0x21 0x04>;
			clocks = <0x33 0x2e 0x33 0x0c>;
			compatible = "rockchip,gpio-bank";
			#interrupt-cells = <0x02>;
			reg = <0x00 0xfdd60000 0x00 0x100>;
			phandle = <0x38>;
			#gpio-cells = <0x02>;
			interrupt-controller;
		};

		emmc {
		};

		pwm15 {

			pwm15m0-pins {
				rockchip,pins = <0x03 0x15 0x01 0x114>;
				phandle = <0x101>;
			};
		};

		spdif {

			spdifm0-tx {
				rockchip,pins = <0x01 0x04 0x04 0x114>;
				phandle = <0xd5>;
			};
		};

		pcie30x2 {
		};

		can0 {
		};

		uart9 {

			uart9m0-xfer {
				rockchip,pins = <0x02 0x07 0x03 0x116 0x02 0x08 0x03 0x116>;
				phandle = <0xf5>;
			};
		};

		pcfg-pull-up {
			phandle = <0x116>;
			bias-pull-up;
		};

		spi3 {

			spi3m0-cs1 {
				rockchip,pins = <0x04 0x07 0x04 0x114>;
				phandle = <0xea>;
			};

			spi3m0-pins {
				rockchip,pins = <0x04 0x0b 0x04 0x114 0x04 0x08 0x04 0x114 0x04 0x0a 0x04 0x114>;
				phandle = <0xeb>;
			};

			spi3m0-cs0 {
				rockchip,pins = <0x04 0x06 0x04 0x114>;
				phandle = <0xe9>;
			};
		};

		spi1-hs {

			spi1m0-pins {
				rockchip,pins = <0x02 0x0d 0x03 0x11b 0x02 0x0e 0x03 0x11b 0x02 0x0f 0x04 0x11b>;
				phandle = <0xe4>;
			};
		};

		bt656 {
		};

		i2s2 {

			i2s2m0-lrcktx {
				rockchip,pins = <0x02 0x13 0x01 0x114>;
				phandle = <0xc7>;
			};

			i2s2m0-sdi {
				rockchip,pins = <0x02 0x15 0x01 0x114>;
				phandle = <0xc8>;
			};

			i2s2m0-sclktx {
				rockchip,pins = <0x02 0x12 0x01 0x114>;
				phandle = <0xc6>;
			};

			i2s2m0-sdo {
				rockchip,pins = <0x02 0x14 0x01 0x114>;
				phandle = <0xc9>;
			};
		};

		i2c2 {

			i2c2m0-xfer {
				rockchip,pins = <0x00 0x0d 0x01 0x119 0x00 0x0e 0x01 0x119>;
				phandle = <0xd9>;
			};
		};

		gmac-txd-level3 {
		};

		pwm8 {

			pwm8m0-pins {
				rockchip,pins = <0x03 0x09 0x05 0x114>;
				phandle = <0xfa>;
			};
		};

		pmic {

			soc_slppin_gpio {
				rockchip,pins = <0x00 0x02 0x00 0x11a>;
				phandle = <0x3c>;
			};

			soc_slppin_slp {
				rockchip,pins = <0x00 0x02 0x01 0x116>;
				phandle = <0x3a>;
			};

			pmic_int {
				rockchip,pins = <0x00 0x03 0x00 0x116>;
				phandle = <0x39>;
			};

			soc_slppin_rst {
				rockchip,pins = <0x00 0x02 0x02 0x114>;
			};
		};

		jtag {
		};

		gmac1 {

			gmac1m1-rgmii-clk {
				rockchip,pins = <0x04 0x03 0x03 0x114 0x04 0x00 0x03 0x118>;
				phandle = <0x86>;
			};

			gmac1m1-miim {
				rockchip,pins = <0x04 0x0e 0x03 0x114 0x04 0x0f 0x03 0x114>;
				phandle = <0x83>;
			};

			gmac1m1-tx-bus2 {
				rockchip,pins = <0x04 0x04 0x03 0x117 0x04 0x05 0x03 0x117 0x04 0x06 0x03 0x114>;
				phandle = <0x84>;
			};

			gmac1m1-rgmii-bus {
				rockchip,pins = <0x04 0x01 0x03 0x114 0x04 0x02 0x03 0x114 0x03 0x1e 0x03 0x117 0x03 0x1f 0x03 0x117>;
				phandle = <0x87>;
			};

			gmac1m1-rx-bus2 {
				rockchip,pins = <0x04 0x07 0x03 0x114 0x04 0x08 0x03 0x114 0x04 0x09 0x03 0x114>;
				phandle = <0x85>;
			};
		};

		pcfg-pull-none {
			bias-disable;
			phandle = <0x114>;
		};

		pwm13 {

			pwm13m0-pins {
				rockchip,pins = <0x03 0x10 0x02 0x114>;
				phandle = <0xff>;
			};
		};

		acodec {

			acodec-pins {
				rockchip,pins = <0x01 0x09 0x05 0x114 0x01 0x01 0x05 0x114 0x01 0x00 0x05 0x114 0x01 0x07 0x05 0x114 0x01 0x08 0x05 0x114 0x01 0x03 0x05 0x114 0x01 0x05 0x05 0x114>;
				phandle = <0xd6>;
			};
		};

		keys {

			reset-button {
				rockchip,pins = <0x00 0x00 0x00 0x116>;
				phandle = <0x12a>;
			};
		};

		uart7 {

			uart7m0-xfer {
				rockchip,pins = <0x02 0x05 0x03 0x116 0x02 0x06 0x03 0x116>;
				phandle = <0xf3>;
			};
		};

		spi1 {

			spi1m0-cs0 {
				rockchip,pins = <0x02 0x10 0x04 0x114>;
				phandle = <0xe1>;
			};

			spi1m0-pins {
				rockchip,pins = <0x02 0x0d 0x03 0x114 0x02 0x0e 0x03 0x114 0x02 0x0f 0x04 0x114>;
				phandle = <0xe3>;
			};

			spi1m0-cs1 {
				rockchip,pins = <0x02 0x16 0x03 0x114>;
				phandle = <0xe2>;
			};
		};

		pcfg-output-low-pull-down {
			bias-pull-down;
			phandle = <0x11a>;
			output-low;
		};

		sdio-pwrseq {

			wifi-enable-h {
				rockchip,pins = <0x03 0x1d 0x00 0x114>;
				phandle = <0x12c>;
			};
		};

		usb {

			vcc5v0-otg-en {
				rockchip,pins = <0x00 0x05 0x00 0x114>;
				phandle = <0x129>;
			};
		};

		pcfg-pull-up-drv-level-1 {
			drive-strength = <0x01>;
			phandle = <0x11b>;
			bias-pull-up;
		};

		pcfg-pull-none-smt {
			bias-disable;
			input-schmitt-enable;
			phandle = <0x119>;
		};

		i2c0 {

			i2c0-xfer {
				rockchip,pins = <0x00 0x09 0x01 0x119 0x00 0x0a 0x01 0x119>;
				phandle = <0x36>;
			};
		};

		pwm6 {

			pwm6-pins {
				rockchip,pins = <0x00 0x15 0x01 0x114>;
				phandle = <0xf8>;
			};
		};

		pwm11 {

			pwm11m0-pins {
				rockchip,pins = <0x03 0x0e 0x05 0x114>;
				phandle = <0xfd>;
			};
		};

		bt1120 {
		};

		uart5 {

			uart5m0-xfer {
				rockchip,pins = <0x02 0x01 0x03 0x116 0x02 0x02 0x03 0x116>;
				phandle = <0xf1>;
			};
		};

		flash {
		};

		vop {
		};

		pwm4 {

			pwm4-pins {
				rockchip,pins = <0x00 0x13 0x01 0x114>;
				phandle = <0xf6>;
			};
		};

		pcfg-pull-none-drv-level-2 {
			drive-strength = <0x02>;
			bias-disable;
			phandle = <0x117>;
		};

		vcc {

			vcc3v3-sys-en {
				rockchip,pins = <0x00 0x0e 0x00 0x114>;
				phandle = <0x127>;
			};
		};

		uart3 {

			uart3m0-xfer {
				rockchip,pins = <0x01 0x00 0x02 0x116 0x01 0x01 0x02 0x116>;
				phandle = <0xef>;
			};
		};

		hdmitx {

			hdmitx-scl {
				rockchip,pins = <0x04 0x17 0x01 0x114>;
				phandle = <0x98>;
			};

			hdmitx-sda {
				rockchip,pins = <0x04 0x18 0x01 0x114>;
				phandle = <0x99>;
			};

			hdmitxm0-cec {
				rockchip,pins = <0x04 0x19 0x01 0x114>;
				phandle = <0x9a>;
			};
		};

		sdmmc2 {

			sdmmc2m0-cmd {
				rockchip,pins = <0x03 0x1a 0x03 0x115>;
				phandle = <0xa0>;
			};

			sdmmc2m0-clk {
				rockchip,pins = <0x03 0x1b 0x03 0x115>;
				phandle = <0xa1>;
			};

			sdmmc2m0-bus4 {
				rockchip,pins = <0x03 0x16 0x03 0x115 0x03 0x17 0x03 0x115 0x03 0x18 0x03 0x115 0x03 0x19 0x03 0x115>;
				phandle = <0x9f>;
			};
		};

		spi3-hs {

			spi3m0-pins {
				rockchip,pins = <0x04 0x0b 0x04 0x11b 0x04 0x08 0x04 0x11b 0x04 0x0a 0x04 0x11b>;
				phandle = <0xec>;
			};
		};

		pwm2 {

			pwm2m0-pins {
				rockchip,pins = <0x00 0x11 0x01 0x114>;
				phandle = <0x44>;
			};
		};

		sata1 {
		};

		spi0-hs {

			spi0m0-pins {
				rockchip,pins = <0x00 0x0d 0x02 0x11b 0x00 0x15 0x02 0x11b 0x00 0x0e 0x02 0x11b>;
				phandle = <0xe0>;
			};
		};

		pmu {
		};

		scr {

			scr-pins {
				rockchip,pins = <0x01 0x02 0x03 0x114 0x01 0x07 0x03 0x116 0x01 0x03 0x03 0x116 0x01 0x05 0x03 0x114>;
				phandle = <0xd7>;
			};
		};

		uart1 {

			uart1m0-xfer {
				rockchip,pins = <0x02 0x0b 0x02 0x116 0x02 0x0c 0x02 0x116>;
				phandle = <0xed>;
			};
		};

		gpio3@fe760000 {
			gpio-controller;
			interrupts = <0x00 0x24 0x04>;
			clocks = <0x20 0x167 0x20 0x168>;
			compatible = "rockchip,gpio-bank";
			#interrupt-cells = <0x02>;
			reg = <0x00 0xfe760000 0x00 0x100>;
			phandle = <0xae>;
			#gpio-cells = <0x02>;
			interrupt-controller;
		};

		i2c5 {

			i2c5m0-xfer {
				rockchip,pins = <0x03 0x0b 0x04 0x119 0x03 0x0c 0x04 0x119>;
				phandle = <0xdc>;
			};
		};

		sdmmc0 {

			sdmmc0-det {
				rockchip,pins = <0x00 0x04 0x01 0x116>;
				phandle = <0xc0>;
			};

			sdmmc0-bus4 {
				rockchip,pins = <0x01 0x1d 0x01 0x115 0x01 0x1e 0x01 0x115 0x01 0x1f 0x01 0x115 0x02 0x00 0x01 0x115>;
				phandle = <0xbd>;
			};

			sdmmc0-cmd {
				rockchip,pins = <0x02 0x01 0x01 0x115>;
				phandle = <0xbf>;
			};

			sdmmc0-clk {
				rockchip,pins = <0x02 0x02 0x01 0x115>;
				phandle = <0xbe>;
			};
		};

		pwm0 {

			pwm0m0-pins {
				rockchip,pins = <0x00 0x0f 0x01 0x114>;
				phandle = <0x42>;
			};
		};

		cif {
		};

		can1 {
		};

		gpio1@fe740000 {
			gpio-controller;
			interrupts = <0x00 0x22 0x04>;
			clocks = <0x20 0x163 0x20 0x164>;
			compatible = "rockchip,gpio-bank";
			#interrupt-cells = <0x02>;
			reg = <0x00 0xfe740000 0x00 0x100>;
			#gpio-cells = <0x02>;
			interrupt-controller;
		};

		pcie20 {
		};

		wireless-wlan {

			wifi-host-wake-irq {
				rockchip,pins = <0x03 0x1c 0x00 0x11d>;
				phandle = <0x12d>;
			};
		};

		i2s3 {

			i2s3m0-lrck {
				rockchip,pins = <0x03 0x04 0x04 0x114>;
				phandle = <0xcb>;
			};

			i2s3m0-sdo {
				rockchip,pins = <0x03 0x05 0x04 0x114>;
				phandle = <0xcd>;
			};

			i2s3m0-sdi {
				rockchip,pins = <0x03 0x06 0x04 0x114>;
				phandle = <0xcc>;
			};

			i2s3m0-sclk {
				rockchip,pins = <0x03 0x03 0x04 0x114>;
				phandle = <0xca>;
			};
		};
	};

	timer@fe5f0000 {
		clock-names = "pclk\0timer";
		interrupts = <0x00 0x6d 0x04>;
		clocks = <0x20 0x16c 0x20 0x16d>;
		compatible = "rockchip,rk3568-timer\0rockchip,rk3288-timer";
		reg = <0x00 0xfe5f0000 0x00 0x1000>;
	};

	qos@fe190200 {
		compatible = "syscon";
		reg = <0x00 0xfe190200 0x00 0x20>;
		phandle = <0x5c>;
	};

	qos@fe158280 {
		compatible = "syscon";
		reg = <0x00 0xfe158280 0x00 0x20>;
		phandle = <0x52>;
	};

	serial@fe6a0000 {
		reg-io-width = <0x04>;
		pinctrl-names = "default";
		pinctrl-0 = <0xf2>;
		clock-names = "baudclk\0apb_pclk";
		interrupts = <0x00 0x7a 0x04>;
		clocks = <0x20 0x133 0x20 0x130>;
		compatible = "rockchip,rk3568-uart\0snps,dw-apb-uart";
		status = "disabled";
		reg = <0x00 0xfe6a0000 0x00 0x100>;
		dmas = <0x40 0x0c 0x40 0x0d>;
		reg-shift = <0x02>;
	};

	qos@fe138100 {
		compatible = "syscon";
		reg = <0x00 0xfe138100 0x00 0x20>;
		phandle = <0x57>;
	};

	interrupt-controller@fd400000 {
		#address-cells = <0x02>;
		interrupts = <0x01 0x09 0x04>;
		#size-cells = <0x02>;
		compatible = "arm,gic-v3";
		ranges;
		#interrupt-cells = <0x03>;
		reg = <0x00 0xfd400000 0x00 0x10000 0x00 0xfd460000 0x00 0xc0000>;
		phandle = <0x01>;
		interrupt-controller;

		interrupt-controller@fd440000 {
			msi-controller;
			compatible = "arm,gic-v3-its";
			reg = <0x00 0xfd440000 0x00 0x20000>;
			phandle = <0xac>;
			#msi-cells = <0x01>;
		};
	};

	i2s@fe430000 {
		pinctrl-names = "default";
		rockchip,cru = <0x20>;
		pinctrl-0 = <0xca 0xcb 0xcc 0xcd>;
		clock-names = "mclk_tx\0mclk_rx\0hclk";
		resets = <0x20 0x55 0x20 0x56>;
		interrupts = <0x00 0x37 0x04>;
		clocks = <0x20 0x53 0x20 0x57 0x20 0x3c>;
		dma-names = "tx\0rx";
		#sound-dai-cells = <0x00>;
		compatible = "rockchip,rk3568-i2s-tdm";
		status = "disabled";
		rockchip,grf = <0x34>;
		reg = <0x00 0xfe430000 0x00 0x1000>;
		dmas = <0xc1 0x06 0xc1 0x07>;
		reset-names = "tx-m\0rx-m";
		rockchip,clk-trcm = <0x01>;
	};

	iommu@fdef0800 {
		power-domains = <0x22 0x0a>;
		clock-names = "aclk\0iface";
		interrupts = <0x00 0x38 0x04>;
		clocks = <0x20 0xf6 0x20 0xf7>;
		#iommu-cells = <0x00>;
		compatible = "rockchip,iommu-v2";
		status = "okay";
		interrupt-names = "iep_mmu";
		reg = <0x00 0xfdef0800 0x00 0x100>;
		phandle = <0x71>;
	};

	rkscr@fe560000 {
		pinctrl-names = "default";
		pinctrl-0 = <0xd7>;
		clock-names = "g_pclk_sim_card";
		interrupts = <0x00 0x61 0x04>;
		clocks = <0x20 0x114>;
		compatible = "rockchip-scr";
		status = "disabled";
		reg = <0x00 0xfe560000 0x00 0x10000>;
	};

	qos@fe1a8080 {
		compatible = "syscon";
		reg = <0x00 0xfe1a8080 0x00 0x20>;
		phandle = <0x4c>;
	};

	phy@fe830000 {
		rockchip,pipe-grf = <0x10b>;
		clock-names = "refclk\0apbclk\0pipe_clk";
		assigned-clocks = <0x33 0x22>;
		assigned-clock-rates = <0x5f5e100>;
		resets = <0x20 0x1c6 0x20 0x1c7>;
		clocks = <0x33 0x22 0x20 0x17d 0x20 0x7f>;
		#phy-cells = <0x01>;
		compatible = "rockchip,rk3568-naneng-combphy";
		status = "okay";
		rockchip,pipe-phy-grf = <0x10d>;
		reg = <0x00 0xfe830000 0x00 0x100>;
		phandle = <0x23>;
		reset-names = "combphy-apb\0combphy";
	};

	watchdog@fe600000 {
		clock-names = "tclk\0pclk";
		interrupts = <0x00 0x95 0x04>;
		clocks = <0x20 0x116 0x20 0x115>;
		compatible = "snps,dw-wdt";
		status = "okay";
		reg = <0x00 0xfe600000 0x00 0x100>;
	};

	rkvenc@fdf40000 {
		power-domains = <0x22 0x0e>;
		iommus = <0x72>;
		clock-names = "aclk_vcodec\0hclk_vcodec\0clk_core";
		assigned-clocks = <0x20 0x103 0x20 0x105>;
		venc-supply = <0x67>;
		rockchip,normal-rates = <0x11b3dc40 0x00 0x11b3dc40>;
		assigned-clock-rates = <0x11b3dc40 0x11b3dc40>;
		resets = <0x20 0x133 0x20 0x134 0x20 0x135>;
		interrupts = <0x00 0x8c 0x04>;
		clocks = <0x20 0x103 0x20 0x104 0x20 0x105>;
		node-name = "rkvenc";
		rockchip,srv = <0x6d>;
		rockchip,taskqueue-node = <0x03>;
		compatible = "rockchip,rkv-encoder-v1";
		rockchip,resetgroup-node = <0x03>;
		status = "okay";
		interrupt-names = "irq_enc";
		reg = <0x00 0xfdf40000 0x00 0x400>;
		reset-names = "video_a\0video_h\0video_core";
		operating-points-v2 = <0x73>;
	};

	rk_rga@fdeb0000 {
		power-domains = <0x22 0x0a>;
		clock-names = "aclk_rga\0hclk_rga\0clk_rga";
		interrupts = <0x00 0x5a 0x04>;
		clocks = <0x20 0xf3 0x20 0xf4 0x20 0xf5>;
		compatible = "rockchip,rga2";
		status = "okay";
		reg = <0x00 0xfdeb0000 0x00 0x1000>;
	};

	qos@fe128000 {
		compatible = "syscon";
		reg = <0x00 0xfe128000 0x00 0x20>;
		phandle = <0x47>;
	};

	dmc {
		downdifferential = <0x14>;
		auto-min-freq = <0x4f1a0>;
		clock-names = "dmc_clk";
		interrupts = <0x00 0x0a 0x04>;
		clocks = <0x02 0x03>;
		upthreshold = <0x28>;
		cpu-bw-dmc-freq = <0x00 0x15e 0x4f1a0 0x15f 0x190 0x80e80 0x191 0x1869f 0xbe6e0>;
		center-supply = <0x67>;
		devfreq-events = <0xa2 0xa3>;
		compatible = "rockchip,rk3568-dmc";
		status = "disabled";
		interrupt-names = "complete";
		phandle = <0x14>;
		vop-bw-dmc-freq = <0x00 0x11e 0x4f1a0 0x11f 0x1869f 0x80e80>;
		operating-points-v2 = <0xa4>;
		vop-frame-bw-dmc-freq = <0x00 0x26c 0x4f1a0 0x26d 0x1869f 0xbe6e0>;
		system-status-level = <0x01 0x04 0x08 0x08 0x02 0x01 0x10 0x04 0x10000 0x04 0x1000 0x08 0x4000 0x08 0x2000 0x08 0xc00 0x08>;
		#cooling-cells = <0x02>;
		auto-freq-en = <0x01>;
	};

	tsadc@fe710000 {
		pinctrl-names = "gpio\0otpout";
		#address-cells = <0x01>;
		nvmem-cells = <0x102 0x103>;
		pinctrl-0 = <0x104>;
		clock-names = "tsadc\0apb_pclk";
		rockchip,hw-tshut-polarity = <0x00>;
		assigned-clocks = <0x20 0x110 0x20 0x111>;
		assigned-clock-rates = <0x1036640 0xaae60>;
		resets = <0x20 0x182 0x20 0x181 0x20 0x1d7>;
		interrupts = <0x00 0x73 0x04>;
		rockchip,hw-tshut-mode = <0x00>;
		clocks = <0x20 0x111 0x20 0x10f>;
		#size-cells = <0x00>;
		#thermal-sensor-cells = <0x01>;
		compatible = "rockchip,rk3568-tsadc";
		pinctrl-1 = <0x105>;
		status = "okay";
		rockchip,grf = <0x34>;
		nvmem-cell-names = "trim_base\0trim_base_frac";
		reg = <0x00 0xfe710000 0x00 0x100>;
		phandle = <0x1c>;
		reset-names = "tsadc\0tsadc-apb\0tsadc-phy";
		rockchip,hw-tshut-temp = <0x1d4c0>;

		tsadc@0 {
			nvmem-cells = <0x106 0x107>;
			nvmem-cell-names = "trim_l\0trim_h";
			reg = <0x00>;
		};

		tsadc@1 {
			nvmem-cells = <0x108 0x109>;
			nvmem-cell-names = "trim_l\0trim_h";
			reg = <0x01>;
		};
	};

	dummy-codec {
		#sound-dai-cells = <0x00>;
		compatible = "rockchip,dummy-codec";
		status = "disabled";
		phandle = <0x122>;
	};

	opp-table2 {
		rockchip,pvtm-ch = <0x00 0x05>;
		nvmem-cells = <0x6a 0x07 0x08 0x6b>;
		rockchip,low-temp = <0x00>;
		rockchip,max-volt = <0xf4240>;
		rockchip,low-temp-adjust-volt = <0x00 0x320 0xc350>;
		compatible = "operating-points-v2";
		nvmem-cell-names = "leakage\0pvtm\0mbist-vmin\0opp-info";
		rockchip,pvtm-voltage-sel = <0x00 0x14820 0x00 0x14821 0x153d8 0x01 0x153d9 0x16378 0x02 0x16379 0x186a0 0x03>;
		phandle = <0x68>;
		rockchip,temp-hysteresis = <0x1388>;
		mbist-vmin = <0xc96a8 0xdbba0 0xe7ef0>;

		opp-300000000 {
			opp-microvolt = <0xcf850 0xcf850 0xf4240>;
			opp-hz = <0x00 0x11e1a300>;
		};

		opp-700000000 {
			opp-microvolt = <0xe7ef0 0xe7ef0 0xf4240>;
			opp-microvolt-L2 = <0xdbba0 0xdbba0 0xf4240>;
			opp-hz = <0x00 0x29b92700>;
			opp-microvolt-L0 = <0xe7ef0 0xe7ef0 0xf4240>;
			opp-microvolt-L3 = <0xd59f8 0xd59f8 0xf4240>;
			opp-microvolt-L1 = <0xe1d48 0xe1d48 0xf4240>;
		};

		opp-200000000 {
			opp-microvolt = <0xcf850 0xcf850 0xf4240>;
			opp-hz = <0x00 0xbebc200>;
		};

		opp-400000000 {
			opp-microvolt = <0xcf850 0xcf850 0xf4240>;
			opp-hz = <0x00 0x17d78400>;
		};

		opp-600000000 {
			opp-microvolt = <0xdbba0 0xdbba0 0xf4240>;
			opp-microvolt-L2 = <0xcf850 0xcf850 0xf4240>;
			opp-hz = <0x00 0x23c34600>;
			opp-microvolt-L0 = <0xdbba0 0xdbba0 0xf4240>;
			opp-microvolt-L3 = <0xcf850 0xcf850 0xf4240>;
			opp-microvolt-L1 = <0xd59f8 0xd59f8 0xf4240>;
		};

		opp-800000000 {
			opp-microvolt = <0xf4240 0xf4240 0xf4240>;
			opp-microvolt-L2 = <0xe7ef0 0xe7ef0 0xf4240>;
			opp-hz = <0x00 0x2faf0800>;
			opp-microvolt-L0 = <0xf4240 0xf4240 0xf4240>;
			opp-microvolt-L3 = <0xe1d48 0xe1d48 0xf4240>;
			opp-microvolt-L1 = <0xee098 0xee098 0xf4240>;
		};
	};

	external-gmac1-clock {
		clock-output-names = "gmac1_clkin";
		#clock-cells = <0x00>;
		clock-frequency = <0x7735940>;
		compatible = "fixed-clock";
	};

	qos@fe138080 {
		compatible = "syscon";
		reg = <0x00 0xfe138080 0x00 0x20>;
		phandle = <0x56>;
	};

	serial@fe670000 {
		reg-io-width = <0x04>;
		pinctrl-names = "default";
		pinctrl-0 = <0xef>;
		clock-names = "baudclk\0apb_pclk";
		interrupts = <0x00 0x77 0x04>;
		clocks = <0x20 0x127 0x20 0x124>;
		compatible = "rockchip,rk3568-uart\0snps,dw-apb-uart";
		status = "disabled";
		reg = <0x00 0xfe670000 0x00 0x100>;
		dmas = <0x40 0x06 0x40 0x07>;
		reg-shift = <0x02>;
	};

	rkcif_dvp_sditf {
		compatible = "rockchip,rkcif-sditf";
		status = "disabled";
		rockchip,cif = <0x7a>;
	};

	vdpu@fdea0400 {
		power-domains = <0x22 0x0b>;
		iommus = <0x6c>;
		clock-names = "aclk_vcodec\0hclk_vcodec";
		resets = <0x20 0x11a 0x20 0x11b>;
		interrupts = <0x00 0x8b 0x04>;
		clocks = <0x20 0xee 0x20 0xef>;
		rockchip,srv = <0x6d>;
		rockchip,taskqueue-node = <0x00>;
		compatible = "rockchip,vpu-decoder-v2";
		rockchip,resetgroup-node = <0x00>;
		status = "okay";
		interrupt-names = "irq_dec";
		reg = <0x00 0xfdea0400 0x00 0x400>;
		reset-names = "video_a\0video_h";
	};

	sdhci@fe310000 {
		clock-names = "core\0bus\0axi\0block\0timer";
		assigned-clocks = <0x20 0x7b 0x20 0x7d 0x20 0x7c>;
		bus-width = <0x08>;
		non-removable;
		assigned-clock-rates = <0xbebc200 0x16e3600 0xbebc200>;
		resets = <0x20 0x78 0x20 0x76 0x20 0x75 0x20 0x77 0x20 0x79>;
		interrupts = <0x00 0x13 0x04>;
		clocks = <0x20 0x7c 0x20 0x7a 0x20 0x79 0x20 0x7b 0x20 0x7d>;
		compatible = "rockchip,rk3568-dwcmshc\0rockchip,dwcmshc-sdhci";
		status = "okay";
		reg = <0x00 0xfe310000 0x00 0x10000>;
		max-frequency = <0xbebc200>;
		reset-names = "core\0bus\0axi\0block\0timer";
		supports-emmc;
	};

	xpcs-gmac1-clock {
		clock-output-names = "clk_gmac1_xpcs_mii";
		#clock-cells = <0x00>;
		clock-frequency = <0x7735940>;
		compatible = "fixed-clock";
	};

	syscon@fdca0000 {
		compatible = "rockchip,rk3568-usb2phy-grf\0syscon";
		reg = <0x00 0xfdca0000 0x00 0x8000>;
		phandle = <0x110>;
	};

	hdmi-sound {
		simple-audio-card,name = "rockchip,hdmi";
		simple-audio-card,format = "i2s";
		compatible = "simple-audio-card";
		status = "okay";
		simple-audio-card,mclk-fs = <0x80>;

		simple-audio-card,cpu {
			sound-dai = <0x11f>;
		};

		simple-audio-card,codec {
			sound-dai = <0x120>;
		};
	};

	can@fe590000 {
		clock-names = "baudclk\0apb_pclk";
		resets = <0x20 0x159 0x20 0x158>;
		interrupts = <0x00 0x03 0x04>;
		clocks = <0x20 0x145 0x20 0x144>;
		compatible = "rockchip,rk3568-can-2.0";
		status = "disabled";
		tx-fifo-depth = <0x01>;
		rx-fifo-depth = <0x06>;
		reg = <0x00 0xfe590000 0x00 0x1000>;
		reset-names = "can\0can-apb";
	};

	uio@fe010000 {
		compatible = "rockchip,uio-gmac";
		status = "disabled";
		reg = <0x00 0xfe010000 0x00 0x10000>;
		rockchip,ethernet = <0x7e>;
	};

	mailbox@fe780000 {
		clock-names = "pclk_mailbox";
		interrupts = <0x00 0xb7 0x04 0x00 0xb8 0x04 0x00 0xb9 0x04 0x00 0xba 0x04>;
		clocks = <0x20 0x11b>;
		#mbox-cells = <0x01>;
		compatible = "rockchip,rk3568-mailbox\0rockchip,rk3368-mailbox";
		status = "disabled";
		reg = <0x00 0xfe780000 0x00 0x1000>;
	};

	usb2-phy@fe8a0000 {
		rockchip,usbgrf = <0x110>;
		clock-output-names = "usb480m_phy";
		clock-names = "phyclk";
		assigned-clocks = <0x20 0x0b>;
		assigned-clock-parents = <0x26>;
		interrupts = <0x00 0x87 0x04>;
		clocks = <0x33 0x13>;
		#clock-cells = <0x00>;
		compatible = "rockchip,rk3568-usb2phy";
		status = "okay";
		reg = <0x00 0xfe8a0000 0x00 0x10000>;
		phandle = <0x26>;

		host-port {
			phy-supply = <0x111>;
			#phy-cells = <0x00>;
			status = "okay";
			phandle = <0x27>;
		};

		otg-port {
			vbus-supply = <0x111>;
			#phy-cells = <0x00>;
			status = "disabled";
			phandle = <0x25>;
		};
	};

	xin32k {
		pinctrl-names = "default";
		clock-output-names = "xin32k";
		pinctrl-0 = <0x1f>;
		#clock-cells = <0x00>;
		clock-frequency = <0x8000>;
		compatible = "fixed-clock";
	};

	pcie@fe280000 {
		power-domains = <0x22 0x0f>;
		vpcie3v3-supply = <0xad>;
		#address-cells = <0x03>;
		phy-names = "pcie-phy";
		bus-range = <0x20 0x2f>;
		clock-names = "aclk_mst\0aclk_slv\0aclk_dbi\0pclk\0aux";
		reg-names = "pcie-dbi\0pcie-apb";
		num-ob-windows = <0x02>;
		resets = <0x20 0xc1>;
		interrupts = <0x00 0xa5 0x04 0x00 0xa4 0x04 0x00 0xa3 0x04 0x00 0xa2 0x04 0x00 0xa1 0x04>;
		clocks = <0x20 0x8f 0x20 0x90 0x20 0x91 0x20 0x92 0x20 0x93>;
		interrupt-map = <0x00 0x00 0x00 0x01 0xb1 0x00 0x00 0x00 0x00 0x02 0xb1 0x01 0x00 0x00 0x00 0x03 0xb1 0x02 0x00 0x00 0x00 0x04 0xb1 0x03>;
		#size-cells = <0x02>;
		max-link-speed = <0x03>;
		device_type = "pci";
		interrupt-map-mask = <0x00 0x00 0x00 0x07>;
		reset-gpios = <0xae 0x04 0x00>;
		num-lanes = <0x02>;
		compatible = "rockchip,rk3568-pcie\0snps,dw-pcie";
		ranges = <0x800 0x00 0xf0000000 0x00 0xf0000000 0x00 0x100000 0x81000000 0x00 0xf0100000 0x00 0xf0100000 0x00 0x100000 0x82000000 0x00 0xf0200000 0x00 0xf0200000 0x00 0x1e00000 0xc3000000 0x03 0x80000000 0x03 0x80000000 0x00 0x40000000>;
		msi-map = <0x2000 0xac 0x2000 0x1000>;
		#interrupt-cells = <0x01>;
		status = "okay";
		interrupt-names = "sys\0pmc\0msg\0legacy\0err";
		phys = <0xb0>;
		num-viewport = <0x08>;
		reg = <0x03 0xc0800000 0x00 0x400000 0x00 0xfe280000 0x00 0x10000>;
		linux,pci-domain = <0x02>;
		reset-names = "pipe";
		num-ib-windows = <0x06>;

		legacy-interrupt-controller {
			#address-cells = <0x00>;
			interrupts = <0x00 0xa2 0x01>;
			interrupt-parent = <0x01>;
			#interrupt-cells = <0x01>;
			phandle = <0xb1>;
			interrupt-controller;
		};
	};

	sata@fc400000 {
		power-domains = <0x22 0x0f>;
		phy-names = "sata-phy";
		clock-names = "sata\0pmalive\0rxoob";
		interrupts = <0x00 0x5f 0x04>;
		clocks = <0x20 0x9b 0x20 0x9c 0x20 0x9d>;
		compatible = "snps,dwc-ahci";
		status = "disabled";
		interrupt-names = "hostc";
		phys = <0x23 0x01>;
		reg = <0x00 0xfc400000 0x00 0x1000>;
		ports-implemented = <0x01>;
	};

	ethernet@fe010000 {
		pinctrl-names = "default";
		phy-mode = "rgmii";
		snps,mixed-burst;
		snps,mtl-rx-config = <0x80>;
		snps,reset-active-low;
		pinctrl-0 = <0x83 0x84 0x85 0x86 0x87>;
		clock-names = "stmmaceth\0mac_clk_rx\0mac_clk_tx\0clk_mac_refout\0aclk_mac\0pclk_mac\0clk_mac_speed\0ptp_ref\0pclk_xpcs\0clk_xpcs_eee";
		assigned-clocks = <0x20 0x189 0x20 0x186>;
		assigned-clock-parents = <0x20 0x187 0x20 0xc5>;
		snps,mtl-tx-config = <0x81>;
		local-mac-address = [66 25 c0 43 f3 00];
		assigned-clock-rates = <0x00 0x7735940>;
		resets = <0x20 0xec>;
		interrupts = <0x00 0x20 0x04 0x00 0x1d 0x04>;
		clocks = <0x20 0x186 0x20 0x189 0x20 0x189 0x20 0xc7 0x20 0xc3 0x20 0xc4 0x20 0x189 0x20 0xc8 0x20 0xac 0x20 0xab>;
		mac-address = [66 25 c0 43 f3 00];
		clock_in_out = "input";
		snps,tso;
		compatible = "rockchip,rk3568-gmac\0snps,dwmac-4.20a";
		status = "okay";
		rockchip,grf = <0x34>;
		interrupt-names = "macirq\0eth_wake_irq";
		snps,reset-gpio = <0x82 0x1d 0x01>;
		reg = <0x00 0xfe010000 0x00 0x10000>;
		rx_delay = <0x26>;
		phandle = <0x7e>;
		phy-handle = <0x88>;
		reset-names = "stmmaceth";
		tx_delay = <0x4f>;
		snps,axi-config = <0x7f>;
		snps,reset-delays-us = <0x00 0x4e20 0x186a0>;

		mdio {
			#address-cells = <0x01>;
			#size-cells = <0x00>;
			compatible = "snps,dwmac-mdio";

			phy@0 {
				compatible = "ethernet-phy-ieee802.3-c22";
				reg = <0x00>;
				phandle = <0x88>;
			};
		};

		tx-queues-config {
			phandle = <0x81>;
			snps,tx-queues-to-use = <0x01>;

			queue0 {
			};
		};

		stmmac-axi-config {
			snps,wr_osr_lmt = <0x04>;
			phandle = <0x7f>;
			snps,blen = <0x00 0x00 0x00 0x00 0x10 0x08 0x04>;
			snps,rd_osr_lmt = <0x08>;
		};

		rx-queues-config {
			snps,rx-queues-to-use = <0x01>;
			phandle = <0x80>;

			queue0 {
			};
		};
	};

	rkisp-vir1 {
		rockchip,hw = <0x7d>;
		compatible = "rockchip,rkisp-vir";
		status = "disabled";
	};

	display-subsystem {
		memory-region-names = "drm-logo\0drm-cubic-lut";
		ports = <0x13>;
		memory-region = <0x11 0x12>;
		compatible = "rockchip,display-subsystem";
		devfreq = <0x14>;

		route {

			route-hdmi {
				logo,kernel = "logo_kernel.bmp";
				logo,uboot = "logo.bmp";
				charge_logo,mode = "center";
				connect = <0x18>;
				logo,mode = "center";
				status = "okay";
			};

			route-lvds {
				logo,kernel = "logo_kernel.bmp";
				logo,uboot = "logo.bmp";
				charge_logo,mode = "center";
				connect = <0x19>;
				logo,mode = "center";
				status = "disabled";
			};

			route-dsi1 {
				logo,kernel = "logo_kernel.bmp";
				logo,uboot = "logo.bmp";
				charge_logo,mode = "center";
				connect = <0x16>;
				logo,mode = "center";
				status = "disabled";
			};

			route-edp {
				logo,kernel = "logo_kernel.bmp";
				logo,uboot = "logo.bmp";
				charge_logo,mode = "center";
				connect = <0x17>;
				logo,mode = "center";
				status = "disabled";
			};

			route-rgb {
				logo,kernel = "logo_kernel.bmp";
				logo,uboot = "logo.bmp";
				charge_logo,mode = "center";
				connect = <0x1a>;
				logo,mode = "center";
				status = "disabled";
			};

			route-dsi0 {
				logo,kernel = "logo_kernel.bmp";
				logo,uboot = "logo.bmp";
				charge_logo,mode = "center";
				connect = <0x15>;
				logo,mode = "center";
				status = "disabled";
			};
		};
	};

	nocp-gpu-vpu-rga-venc@fe102400 {
		compatible = "rockchip,rk3568-nocp";
		reg = <0x00 0xfe102400 0x00 0x400>;
	};

	edp@fe0c0000 {
		power-domains = <0x22 0x09>;
		phy-names = "dp";
		clock-names = "dp\0pclk\0spdif\0hclk";
		resets = <0x20 0x113 0x20 0x112>;
		interrupts = <0x00 0x12 0x04>;
		clocks = <0x33 0x29 0x20 0xea 0x20 0xeb 0x20 0xda>;
		compatible = "rockchip,rk3568-edp";
		status = "disabled";
		phys = <0x9c>;
		reg = <0x00 0xfe0c0000 0x00 0x10000>;
		reset-names = "dp\0apb";

		ports {
			#address-cells = <0x01>;
			#size-cells = <0x00>;

			port@0 {
				#address-cells = <0x01>;
				#size-cells = <0x00>;
				reg = <0x00>;

				endpoint@1 {
					remote-endpoint = <0x9d>;
					status = "disabled";
					reg = <0x01>;
					phandle = <0x90>;
				};

				endpoint@0 {
					remote-endpoint = <0x17>;
					status = "disabled";
					reg = <0x00>;
					phandle = <0x8c>;
				};
			};
		};
	};

	spi@fe630000 {
		pinctrl-names = "default\0high_speed";
		#address-cells = <0x01>;
		num-cs = <0x02>;
		pinctrl-0 = <0xe5 0xe6 0xe7>;
		clock-names = "spiclk\0apb_pclk";
		interrupts = <0x00 0x69 0x04>;
		clocks = <0x20 0x156 0x20 0x155>;
		#size-cells = <0x00>;
		dma-names = "tx\0rx";
		compatible = "rockchip,rk3066-spi";
		pinctrl-1 = <0xe5 0xe6 0xe8>;
		status = "disabled";
		reg = <0x00 0xfe630000 0x00 0x1000>;
		dmas = <0x40 0x18 0x40 0x19>;
	};

	adc-keys {
		io-channels = <0x11e 0x00>;
		poll-interval = <0x64>;
		keyup-threshold-microvolt = <0x1b7740>;
		compatible = "adc-keys";
		io-channel-names = "buttons";

		menu-key {
			press-threshold-microvolt = <0xef420>;
			label = "menu";
			linux,code = <0x8b>;
		};

		vol-up-key {
			press-threshold-microvolt = <0x6d6>;
			label = "volume up";
			linux,code = <0x73>;
		};

		back-key {
			press-threshold-microvolt = <0x13eb9c>;
			label = "back";
			linux,code = <0x9e>;
		};

		vol-down-key {
			press-threshold-microvolt = <0x48a1c>;
			label = "volume down";
			linux,code = <0x72>;
		};
	};

	i2c@fe5d0000 {
		pinctrl-names = "default";
		#address-cells = <0x01>;
		pinctrl-0 = <0xdb>;
		clock-names = "i2c\0pclk";
		interrupts = <0x00 0x32 0x04>;
		clocks = <0x20 0x14e 0x20 0x14d>;
		#size-cells = <0x00>;
		compatible = "rockchip,rk3399-i2c";
		status = "disabled";
		reg = <0x00 0xfe5d0000 0x00 0x1000>;
	};

	clock-controller@fdd00000 {
		#reset-cells = <0x01>;
		assigned-clocks = <0x33 0x32>;
		assigned-clock-parents = <0x33 0x05>;
		#clock-cells = <0x01>;
		rockchip,pmugrf = <0x35>;
		compatible = "rockchip,rk3568-pmucru";
		rockchip,grf = <0x34>;
		reg = <0x00 0xfdd00000 0x00 0x1000>;
		phandle = <0x33>;
	};

	arm-pmu {
		interrupt-affinity = <0x0a 0x0b 0x0c 0x0d>;
		interrupts = <0x00 0xe4 0x04 0x00 0xe5 0x04 0x00 0xe6 0x04 0x00 0xe7 0x04>;
		compatible = "arm,cortex-a55-pmu\0arm,armv8-pmuv3";
	};

	nocp-vi-usb-peri-pipe@fe102c00 {
		compatible = "rockchip,rk3568-nocp";
		reg = <0x00 0xfe102c00 0x00 0x400>;
	};

	rkisp@fdff0000 {
		power-domains = <0x22 0x08>;
		iommus = <0x7c>;
		rockchip,iq-feature = <0x1bfb 0xfffe67ff>;
		clock-names = "aclk_isp\0hclk_isp\0clk_isp";
		resets = <0x20 0xfd 0x20 0xfc>;
		interrupts = <0x00 0x39 0x04 0x00 0x3a 0x04 0x00 0x3c 0x04>;
		clocks = <0x20 0xd2 0x20 0xd3 0x20 0xd4>;
		compatible = "rockchip,rk3568-rkisp";
		status = "disabled";
		rockchip,grf = <0x34>;
		interrupt-names = "mipi_irq\0mi_irq\0isp_irq";
		reg = <0x00 0xfdff0000 0x00 0x10000>;
		phandle = <0x7d>;
		reset-names = "isp\0isp-h";
	};

	rkcif_mipi_lvds_sditf {
		compatible = "rockchip,rkcif-sditf";
		status = "disabled";
		rockchip,cif = <0x7b>;
	};

	thermal-zones {

		soc-thermal {
			polling-delay = <0x3e8>;
			polling-delay-passive = <0x14>;
			thermal-sensors = <0x1c 0x00>;
			sustainable-power = <0x389>;

			trips {

				trip-point-0 {
					temperature = <0x124f8>;
					hysteresis = <0x7d0>;
					type = "passive";
				};

				trip-point-1 {
					temperature = <0x14c08>;
					hysteresis = <0x7d0>;
					type = "passive";
					phandle = <0x1d>;
				};

				soc-crit {
					temperature = <0x1c138>;
					hysteresis = <0x7d0>;
					type = "critical";
				};
			};

			cooling-maps {

				map0 {
					trip = <0x1d>;
					cooling-device = <0x0a 0xffffffff 0xffffffff>;
					contribution = <0x400>;
				};

				map1 {
					trip = <0x1d>;
					cooling-device = <0x1e 0xffffffff 0xffffffff>;
					contribution = <0x400>;
				};
			};
		};

		gpu-thermal {
			polling-delay = <0x3e8>;
			polling-delay-passive = <0x14>;
			thermal-sensors = <0x1c 0x01>;
		};
	};

	cspmu@fd90c000 {
		compatible = "rockchip,cspmu";
		reg = <0x00 0xfd90c000 0x00 0x1000 0x00 0xfd90d000 0x00 0x1000 0x00 0xfd90e000 0x00 0x1000 0x00 0xfd90f000 0x00 0x1000>;
	};

	syscon@fdc70000 {
		compatible = "rockchip,pipe-phy-grf\0syscon";
		reg = <0x00 0xfdc70000 0x00 0x1000>;
		phandle = <0x10c>;
	};

	qos@fe158200 {
		compatible = "syscon";
		reg = <0x00 0xfe158200 0x00 0x20>;
		phandle = <0x51>;
	};

	spdif-sound {
		simple-audio-card,name = "ROCKCHIP,SPDIF";
		compatible = "simple-audio-card";
		status = "disabled";
		simple-audio-card,mclk-fs = <0x80>;

		simple-audio-card,cpu {
			sound-dai = <0x124>;
		};

		simple-audio-card,codec {
			sound-dai = <0x125>;
		};
	};

	vcc5v0-sys {
		regulator-max-microvolt = <0x4c4b40>;
		regulator-boot-on;
		regulator-always-on;
		regulator-min-microvolt = <0x4c4b40>;
		regulator-name = "vcc5v0_sys";
		compatible = "regulator-fixed";
		phandle = <0x128>;
		vin-supply = <0x126>;
	};

	i2s@fe400000 {
		rockchip,cru = <0x20>;
		clock-names = "mclk_tx\0mclk_rx\0hclk";
		resets = <0x20 0x50 0x20 0x51>;
		interrupts = <0x00 0x34 0x04>;
		clocks = <0x20 0x3f 0x20 0x43 0x20 0x39>;
		dma-names = "tx";
		#sound-dai-cells = <0x00>;
		compatible = "rockchip,rk3568-i2s-tdm";
		rockchip,playback-only;
		status = "okay";
		rockchip,grf = <0x34>;
		reg = <0x00 0xfe400000 0x00 0x1000>;
		phandle = <0x11f>;
		dmas = <0xc1 0x00>;
		reset-names = "tx-m\0rx-m";
	};

	dmac@fe530000 {
		clock-names = "apb_pclk";
		interrupts = <0x00 0x0e 0x04 0x00 0x0d 0x04>;
		clocks = <0x20 0x10d>;
		arm,pl330-periph-burst;
		compatible = "arm,pl330\0arm,primecell";
		reg = <0x00 0xfe530000 0x00 0x4000>;
		phandle = <0x40>;
		#dma-cells = <0x01>;
	};

	jpegd@fded0000 {
		power-domains = <0x22 0x0a>;
		iommus = <0x6f>;
		clock-names = "aclk_vcodec\0hclk_vcodec";
		resets = <0x20 0x12c 0x20 0x12d>;
		interrupts = <0x00 0x3e 0x04>;
		clocks = <0x20 0xfb 0x20 0xfc>;
		rockchip,srv = <0x6d>;
		rockchip,taskqueue-node = <0x01>;
		rockchip,disable-auto-freq;
		compatible = "rockchip,rkv-jpeg-decoder-v1";
		rockchip,resetgroup-node = <0x01>;
		status = "okay";
		reg = <0x00 0xfded0000 0x00 0x400>;
		reset-names = "video_a\0video_h";
	};

	csi2-dphy1 {
		rockchip,hw = <0x10f>;
		compatible = "rockchip,rk3568-csi2-dphy";
		status = "disabled";
	};

	qos@fe1a8000 {
		compatible = "syscon";
		reg = <0x00 0xfe1a8000 0x00 0x20>;
		phandle = <0x4b>;
	};

	serial@fe6b0000 {
		reg-io-width = <0x04>;
		pinctrl-names = "default";
		pinctrl-0 = <0xf3>;
		clock-names = "baudclk\0apb_pclk";
		interrupts = <0x00 0x7b 0x04>;
		clocks = <0x20 0x137 0x20 0x134>;
		compatible = "rockchip,rk3568-uart\0snps,dw-apb-uart";
		status = "disabled";
		reg = <0x00 0xfe6b0000 0x00 0x100>;
		dmas = <0x40 0x0e 0x40 0x0f>;
		reg-shift = <0x02>;
	};

	qos@fe148100 {
		compatible = "syscon";
		reg = <0x00 0xfe148100 0x00 0x20>;
		phandle = <0x4a>;
	};

	npu@fde40000 {
		power-domains = <0x22 0x06>;
		iommus = <0x62>;
		clock-names = "scmi_clk\0clk\0aclk\0hclk";
		assigned-clocks = <0x20 0x23>;
		rknpu-supply = <0x63>;
		assigned-clock-rates = <0x23c34600>;
		resets = <0x20 0x2b 0x20 0x2c>;
		interrupts = <0x00 0x97 0x04>;
		clocks = <0x02 0x02 0x20 0x23 0x20 0x28 0x20 0x29>;
		compatible = "rockchip,rk3568-rknpu\0rockchip,rknpu";
		status = "disabled";
		reg = <0x00 0xfde40000 0x00 0x10000>;
		reset-names = "srst_a\0srst_h";
		operating-points-v2 = <0x61>;
	};

	leds {
		pinctrl-names = "default";
		pinctrl-0 = <0x131>;
		compatible = "gpio-leds";

		green {
			linux,default-trigger = "timer";
			label = "green:sys";
			gpios = <0x82 0x1f 0x00>;
		};
	};

	uio@fe2a0000 {
		compatible = "rockchip,uio-gmac";
		status = "disabled";
		reg = <0x00 0xfe2a0000 0x00 0x10000>;
		rockchip,ethernet = <0xb2>;
	};

	qos@fe190100 {
		compatible = "syscon";
		reg = <0x00 0xfe190100 0x00 0x20>;
		phandle = <0x5b>;
	};

	psci {
		method = "smc";
		compatible = "arm,psci-1.0";
	};

	phy@fe840000 {
		rockchip,pipe-grf = <0x10b>;
		clock-names = "refclk\0apbclk\0pipe_clk";
		assigned-clocks = <0x33 0x25>;
		assigned-clock-rates = <0x5f5e100>;
		resets = <0x20 0x1c8 0x20 0x1c9>;
		clocks = <0x33 0x25 0x20 0x17e 0x20 0x7f>;
		#phy-cells = <0x01>;
		compatible = "rockchip,rk3568-naneng-combphy";
		status = "okay";
		rockchip,pipe-phy-grf = <0x10e>;
		reg = <0x00 0xfe840000 0x00 0x100>;
		phandle = <0x24>;
		reset-names = "combphy-apb\0combphy";
	};

	usb@fd800000 {
		phy-names = "usb2-phy";
		clock-names = "usbhost\0arbiter\0pclk\0utmi";
		interrupts = <0x00 0x82 0x04>;
		clocks = <0x20 0xbd 0x20 0xbe 0x20 0xbc 0x28>;
		compatible = "generic-ehci";
		status = "okay";
		phys = <0x29>;
		reg = <0x00 0xfd800000 0x00 0x40000>;
	};

	xin24m {
		clock-output-names = "xin24m";
		#clock-cells = <0x00>;
		clock-frequency = <0x16e3600>;
		compatible = "fixed-clock";
	};

	iommu@fdf40f00 {
		power-domains = <0x22 0x0e>;
		clock-names = "aclk\0iface";
		interrupts = <0x00 0x8d 0x04 0x00 0x8e 0x04>;
		clocks = <0x20 0x103 0x20 0x104>;
		rockchip,enable-cmd-retry;
		#iommu-cells = <0x00>;
		compatible = "rockchip,iommu-v2";
		rockchip,disable-mmu-reset;
		status = "okay";
		interrupt-names = "rkvenc_mmu0\0rkvenc_mmu1";
		reg = <0x00 0xfdf40f00 0x00 0x40 0x00 0xfdf40f40 0x00 0x40>;
		phandle = <0x72>;
	};

	ethernet@fe2a0000 {
		pinctrl-names = "default";
		phy-mode = "rgmii";
		snps,mixed-burst;
		snps,mtl-rx-config = <0xb4>;
		snps,reset-active-low;
		pinctrl-0 = <0xb6 0xb7 0xb8 0xb9 0xba>;
		clock-names = "stmmaceth\0mac_clk_rx\0mac_clk_tx\0clk_mac_refout\0aclk_mac\0pclk_mac\0clk_mac_speed\0ptp_ref\0pclk_xpcs\0clk_xpcs_eee";
		assigned-clocks = <0x20 0x185 0x20 0x182>;
		assigned-clock-parents = <0x20 0x183 0x20 0xb6>;
		snps,mtl-tx-config = <0xb5>;
		local-mac-address = [62 25 c0 43 f3 00];
		assigned-clock-rates = <0x00 0x7735940>;
		resets = <0x20 0xd7>;
		interrupts = <0x00 0x1b 0x04 0x00 0x18 0x04>;
		clocks = <0x20 0x182 0x20 0x185 0x20 0x185 0x20 0xb8 0x20 0xb4 0x20 0xb5 0x20 0x185 0x20 0xb9 0x20 0xac 0x20 0xab>;
		mac-address = [62 25 c0 43 f3 00];
		clock_in_out = "input";
		snps,tso;
		compatible = "rockchip,rk3568-gmac\0snps,dwmac-4.20a";
		status = "okay";
		rockchip,grf = <0x34>;
		interrupt-names = "macirq\0eth_wake_irq";
		snps,reset-gpio = <0x82 0x1b 0x01>;
		reg = <0x00 0xfe2a0000 0x00 0x10000>;
		rx_delay = <0x2f>;
		phandle = <0xb2>;
		phy-handle = <0xbb>;
		reset-names = "stmmaceth";
		tx_delay = <0x3c>;
		snps,axi-config = <0xb3>;
		snps,reset-delays-us = <0x00 0x4e20 0x186a0>;

		mdio {
			#address-cells = <0x01>;
			#size-cells = <0x00>;
			compatible = "snps,dwmac-mdio";

			phy@0 {
				compatible = "ethernet-phy-ieee802.3-c22";
				reg = <0x00>;
				phandle = <0xbb>;
			};
		};

		tx-queues-config {
			phandle = <0xb5>;
			snps,tx-queues-to-use = <0x01>;

			queue0 {
			};
		};

		stmmac-axi-config {
			snps,wr_osr_lmt = <0x04>;
			phandle = <0xb3>;
			snps,blen = <0x00 0x00 0x00 0x00 0x10 0x08 0x04>;
			snps,rd_osr_lmt = <0x08>;
		};

		rx-queues-config {
			snps,rx-queues-to-use = <0x01>;
			phandle = <0xb4>;

			queue0 {
			};
		};
	};

	dmc-fsp {
		debug_print_level = <0x00>;
		ddr3_params = <0xa5>;
		lpddr4x_params = <0xa9>;
		ddr4_params = <0xa6>;
		lpddr3_params = <0xa7>;
		lpddr4_params = <0xa8>;
		compatible = "rockchip,rk3568-dmc-fsp";
		status = "okay";
	};

	qos@fe158180 {
		compatible = "syscon";
		reg = <0x00 0xfe158180 0x00 0x20>;
		phandle = <0x50>;
	};

	qos@fe180000 {
		compatible = "syscon";
		reg = <0x00 0xfe180000 0x00 0x20>;
		phandle = <0x46>;
	};

	usb@fd840000 {
		phy-names = "usb2-phy";
		clock-names = "usbhost\0arbiter\0pclk\0utmi";
		interrupts = <0x00 0x83 0x04>;
		clocks = <0x20 0xbd 0x20 0xbe 0x20 0xbc 0x28>;
		compatible = "generic-ohci";
		status = "okay";
		phys = <0x29>;
		reg = <0x00 0xfd840000 0x00 0x40000>;
	};

	hdmi@fe0a0000 {
		power-domains = <0x22 0x09>;
		reg-io-width = <0x04>;
		rockchip,phy-table = <0x58834d4 0x8009 0x00 0x270 0x9d5b340 0x800b 0x00 0x26d 0xb1069a8 0x800b 0x00 0x1ed 0x11b3dc40 0x800b 0x00 0x1ad 0x2367b880 0x8029 0x00 0x88 0x00 0x00 0x00 0x00>;
		pinctrl-names = "default";
		pinctrl-0 = <0x98 0x99 0x9a>;
		clock-names = "iahb\0isfr\0cec\0ref\0hclk";
		interrupts = <0x00 0x2d 0x04>;
		clocks = <0x20 0xe6 0x20 0xe7 0x20 0x193 0x33 0x02 0x20 0xde>;
		#sound-dai-cells = <0x00>;
		compatible = "rockchip,rk3568-dw-hdmi";
		status = "okay";
		rockchip,grf = <0x34>;
		reg = <0x00 0xfe0a0000 0x00 0x20000>;
		phandle = <0x120>;

		ports {
			#address-cells = <0x01>;
			#size-cells = <0x00>;

			port@0 {
				#address-cells = <0x01>;
				#size-cells = <0x00>;
				reg = <0x00>;

				endpoint@1 {
					remote-endpoint = <0x9b>;
					status = "disabled";
					reg = <0x01>;
					phandle = <0x91>;
				};

				endpoint@0 {
					remote-endpoint = <0x18>;
					status = "okay";
					reg = <0x00>;
					phandle = <0x8d>;
				};
			};
		};
	};

	power-management@fdd90000 {
		compatible = "rockchip,rk3568-pmu\0syscon\0simple-mfd";
		reg = <0x00 0xfdd90000 0x00 0x1000>;

		power-controller {
			#address-cells = <0x01>;
			#size-cells = <0x00>;
			#power-domain-cells = <0x01>;
			compatible = "rockchip,rk3568-power-controller";
			status = "okay";
			phandle = <0x22>;

			pd_pipe@15 {
				clocks = <0x20 0x7f>;
				reg = <0x0f>;
				pm_qos = <0x59 0x5a 0x5b 0x5c 0x5d 0x5e 0x5f 0x60>;
			};

			pd_vi@8 {
				clocks = <0x20 0xcc 0x20 0xcd>;
				reg = <0x08>;
				pm_qos = <0x48 0x49 0x4a>;
			};

			pd_rkvenc@14 {
				clocks = <0x20 0x102>;
				reg = <0x0e>;
				pm_qos = <0x56 0x57 0x58>;
			};

			pd_rga@10 {
				clocks = <0x20 0xf1 0x20 0xf2>;
				reg = <0x0a>;
				pm_qos = <0x4e 0x4f 0x50 0x51 0x52 0x53>;
			};

			pd_vpu@11 {
				clocks = <0x20 0xed>;
				reg = <0x0b>;
				pm_qos = <0x54>;
			};

			pd_gpu@7 {
				clocks = <0x20 0x19 0x20 0x1a>;
				reg = <0x07>;
				pm_qos = <0x47>;
			};

			pd_rkvdec@13 {
				clocks = <0x20 0x107>;
				reg = <0x0d>;
				pm_qos = <0x55>;
			};

			pd_vo@9 {
				clocks = <0x20 0xda 0x20 0xdb 0x20 0xdc>;
				reg = <0x09>;
				pm_qos = <0x4b 0x4c 0x4d>;
			};

			pd_npu@6 {
				clocks = <0x20 0x27 0x20 0x25 0x20 0x26>;
				reg = <0x06>;
				pm_qos = <0x46>;
			};
		};
	};

	vad@fe450000 {
		rockchip,det-channel = <0x00>;
		rockchip,audio-src = <0xd4>;
		clock-names = "hclk";
		reg-names = "vad";
		interrupts = <0x00 0x89 0x04>;
		clocks = <0x20 0x5b>;
		#sound-dai-cells = <0x00>;
		compatible = "rockchip,rk3568-vad";
		status = "disabled";
		rockchip,mode = <0x00>;
		reg = <0x00 0xfe450000 0x00 0x10000>;
		rockchip,buffer-time-ms = <0x80>;
	};

	qos@fe148080 {
		compatible = "syscon";
		reg = <0x00 0xfe148080 0x00 0x20>;
		phandle = <0x49>;
	};

	serial@fe680000 {
		reg-io-width = <0x04>;
		pinctrl-names = "default";
		pinctrl-0 = <0xf0>;
		clock-names = "baudclk\0apb_pclk";
		interrupts = <0x00 0x78 0x04>;
		clocks = <0x20 0x12b 0x20 0x128>;
		compatible = "rockchip,rk3568-uart\0snps,dw-apb-uart";
		status = "disabled";
		reg = <0x00 0xfe680000 0x00 0x100>;
		dmas = <0x40 0x08 0x40 0x09>;
		reg-shift = <0x02>;
	};

	usb@fd880000 {
		phy-names = "usb2-phy";
		clock-names = "usbhost\0arbiter\0pclk\0utmi";
		interrupts = <0x00 0x85 0x04>;
		clocks = <0x20 0xbf 0x20 0xc0 0x20 0xbc 0x28>;
		compatible = "generic-ehci";
		status = "okay";
		phys = <0x2a>;
		reg = <0x00 0xfd880000 0x00 0x40000>;
	};

	qos@fe190080 {
		compatible = "syscon";
		reg = <0x00 0xfe190080 0x00 0x20>;
		phandle = <0x5a>;
	};

	audpwm@fe470000 {
		clock-names = "clk\0hclk";
		clocks = <0x20 0x63 0x20 0x60>;
		rockchip,sample-width-bits = <0x0b>;
		dma-names = "tx";
		rockchip,interpolat-points = <0x01>;
		#sound-dai-cells = <0x00>;
		compatible = "rockchip,rk3568-audio-pwm\0rockchip,audio-pwm-v1";
		status = "disabled";
		reg = <0x00 0xfe470000 0x00 0x1000>;
		dmas = <0xc1 0x08>;
	};

	qos@fe190400 {
		compatible = "syscon";
		reg = <0x00 0xfe190400 0x00 0x20>;
		phandle = <0x60>;
	};

	saradc@fe720000 {
		vref-supply = <0x10a>;
		clock-names = "saradc\0apb_pclk";
		resets = <0x20 0x180>;
		interrupts = <0x00 0x5d 0x04>;
		clocks = <0x20 0x113 0x20 0x112>;
		#io-channel-cells = <0x01>;
		compatible = "rockchip,rk3568-saradc\0rockchip,rk3399-saradc";
		status = "okay";
		reg = <0x00 0xfe720000 0x00 0x100>;
		phandle = <0x11e>;
		reset-names = "saradc-apb";
	};

	dfi@fe230000 {
		rockchip,pmugrf = <0x35>;
		compatible = "rockchip,rk3568-dfi";
		status = "okay";
		reg = <0x00 0xfe230000 0x00 0x400>;
		phandle = <0xa2>;
	};

	syscon@fdcb0000 {
		clocks = <0x20 0x192>;
		compatible = "rockchip,rk3568-edp-phy-grf\0syscon\0simple-mfd";
		reg = <0x00 0xfdcb0000 0x00 0x100>;

		edp-phy {
			clock-names = "refclk";
			clocks = <0x33 0x29>;
			#phy-cells = <0x00>;
			compatible = "rockchip,rk3568-edp-phy";
			status = "disabled";
			phandle = <0x9c>;
		};
	};

	gpio-keys {
		pinctrl-names = "default";
		pinctrl-0 = <0x12a>;
		compatible = "gpio-keys";

		button@1 {
			label = "reset_button";
			linux,input-type = <0x01>;
			linux,code = <0x198>;
			debounce-interval = <0x3c>;
			gpios = <0x38 0x00 0x01>;
		};
	};

	ddr3-params {
		dram_dq_drv_odten = <0x22>;
		reserved = <0x00>;
		phy_dll_dis_freq = <0x00>;
		pd_dis_freq = <0x42a>;
		phy_clk_drv_odtoff = <0x21>;
		phy_odt_puup_en = <0x01>;
		dram_odt = <0x78>;
		standby_idle = <0x00>;
		dq_map_cs0_dq_l = <0x00>;
		dram_dq_drv_odtoff = <0x22>;
		phy_dq_sr_odten = <0x0f>;
		speed_bin = <0x15>;
		dq_map_cs1_dq_h = <0x00>;
		freq_4 = <0x00>;
		sr_dis_freq = <0x320>;
		dram_dq_odt_en_freq = <0x14d>;
		phy_clk_sr_odtoff = <0x00>;
		freq_2 = <0x210>;
		phy_clk_drv_odten = <0x21>;
		phy_dq_drv_odtoff = <0x21>;
		dq_map_cs0_dq_h = <0x00>;
		phy_ca_sr_odten = <0x03>;
		sr_idle = <0x5d>;
		ssmod_div = <0x00>;
		freq_0 = <0x420>;
		phy_clk_sr_odten = <0x00>;
		phy_odt = <0xa7>;
		phy_dq_sr_odtoff = <0x0f>;
		phy_dq_drv_odten = <0x21>;
		phy_odt_en_freq = <0x14d>;
		sr_mc_gate_idle = <0x00>;
		pd_idle = <0x0d>;
		dram_dll_dis_freq = <0x12c>;
		ssmod_downspread = <0x00>;
		phy_odt_pudn_en = <0x01>;
		freq_5 = <0x00>;
		ssmod_spread = <0x00>;
		freq_3 = <0x30c>;
		phandle = <0xa5>;
		expanded_version = <0x00>;
		phy_ca_drv_odtoff = <0x21>;
		version = <0x100>;
		dram_ext_temp = <0x00>;
		phy_ca_sr_odtoff = <0x03>;
		freq_1 = <0x144>;
		phy_ca_drv_odten = <0x21>;
		mode_2t = <0x00>;
		srpd_lite_idle = <0x00>;
		byte_map = <0xe4>;
		dq_map_cs1_dq_l = <0x00>;
	};

	usb2-phy@fe8b0000 {
		rockchip,usbgrf = <0x112>;
		clock-names = "phyclk";
		interrupts = <0x00 0x88 0x04>;
		clocks = <0x33 0x15>;
		#clock-cells = <0x00>;
		compatible = "rockchip,rk3568-usb2phy";
		status = "okay";
		reg = <0x00 0xfe8b0000 0x00 0x10000>;
		phandle = <0x28>;

		host-port {
			phy-supply = <0x111>;
			#phy-cells = <0x00>;
			status = "okay";
			phandle = <0x2a>;
		};

		otg-port {
			phy-supply = <0x111>;
			#phy-cells = <0x00>;
			status = "okay";
			phandle = <0x29>;
		};
	};

	lpddr4x-params {
		dram_dq_drv_odten = <0x28>;
		reserved = <0x00>;
		phy_dll_dis_freq = <0x00>;
		pd_dis_freq = <0x42a>;
		phy_clk_drv_odtoff = <0x24>;
		phy_odt_puup_en = <0x00>;
		dram_odt = <0x50>;
		standby_idle = <0x00>;
		dq_map_cs0_dq_l = <0x00>;
		dram_dq_drv_odtoff = <0x28>;
		phy_dq_sr_odten = <0x00>;
		lp4_ca_odt_en_freq = <0x320>;
		speed_bin = <0x00>;
		dq_map_cs1_dq_h = <0x00>;
		freq_4 = <0x00>;
		sr_dis_freq = <0x320>;
		dram_dq_odt_en_freq = <0x320>;
		phy_clk_sr_odtoff = <0x00>;
		phy_lp4_cs_drv_odten = <0x00>;
		freq_2 = <0x210>;
		phy_clk_drv_odten = <0x24>;
		phy_dq_drv_odtoff = <0x1d>;
		dq_map_cs0_dq_h = <0x00>;
		phy_lp4_drv_pulldown_en_odten = <0x00>;
		lp4_drv_pu_cal_odten = <0x00>;
		phy_ca_sr_odten = <0x00>;
		sr_idle = <0x5d>;
		phy_lp4_drv_pulldown_en_odtoff = <0x00>;
		ssmod_div = <0x00>;
		freq_0 = <0x618>;
		phy_clk_sr_odten = <0x00>;
		phy_odt = <0x3c>;
		phy_dq_sr_odtoff = <0x00>;
		lp4_dq_vref_odten = <0xe4>;
		lp4_ca_odt = <0x78>;
		phy_dq_drv_odten = <0x1d>;
		phy_lp4_dq_vref_odten = <0xa6>;
		phy_odt_en_freq = <0x320>;
		sr_mc_gate_idle = <0x00>;
		pd_idle = <0x0d>;
		lp4_dq_vref_odtoff = <0x1a4>;
		dram_dll_dis_freq = <0x00>;
		ssmod_downspread = <0x00>;
		phy_odt_pudn_en = <0x00>;
		freq_5 = <0x00>;
		ssmod_spread = <0x00>;
		phy_lp4_dq_vref_odtoff = <0x1a4>;
		phy_lp4_cs_drv_odtoff = <0x00>;
		lp4_ca_vref_odtoff = <0x157>;
		freq_3 = <0x30c>;
		lp4_drv_pu_cal_odtoff = <0x00>;
		phandle = <0xa9>;
		expanded_version = <0x00>;
		phy_ca_drv_odtoff = <0x24>;
		lp4_odte_ck_en = <0x00>;
		lp4_odte_cs_en = <0x00>;
		version = <0x100>;
		dram_ext_temp = <0x00>;
		phy_ca_sr_odtoff = <0x00>;
		freq_1 = <0x144>;
		lp4_ca_vref_odten = <0x157>;
		phy_ca_drv_odten = <0x24>;
		lp4_odtd_ca_en = <0x00>;
		mode_2t = <0x00>;
		srpd_lite_idle = <0x00>;
		byte_map = <0xe4>;
		dq_map_cs1_dq_l = <0x00>;
	};

	syscon@fdca8000 {
		compatible = "rockchip,rk3568-usb2phy-grf\0syscon";
		reg = <0x00 0xfdca8000 0x00 0x8000>;
		phandle = <0x112>;
	};

	npu-opp-table {
		rockchip,pvtm-ch = <0x00 0x05>;
		nvmem-cells = <0x64 0x07 0x08 0x65>;
		rockchip,low-temp = <0x00>;
		rockchip,max-volt = <0xf4240>;
		rockchip,low-temp-adjust-volt = <0x00 0x3e8 0xc350>;
		compatible = "operating-points-v2";
		nvmem-cell-names = "leakage\0pvtm\0mbist-vmin\0opp-info";
		rockchip,pvtm-voltage-sel = <0x00 0x14820 0x00 0x14821 0x153d8 0x01 0x153d9 0x16378 0x02 0x16379 0x186a0 0x03>;
		phandle = <0x61>;
		rockchip,temp-hysteresis = <0x1388>;
		mbist-vmin = <0xc96a8 0xdbba0 0xe7ef0>;

		opp-300000000 {
			opp-microvolt = <0xcf850 0xcf850 0xf4240>;
			opp-hz = <0x00 0x11b3dc40>;
		};

		opp-700000000 {
			opp-microvolt = <0xd59f8 0xd59f8 0xf4240>;
			opp-microvolt-L2 = <0xcf850 0xcf850 0xf4240>;
			opp-hz = <0x00 0x29b92700>;
			opp-microvolt-L0 = <0xd59f8 0xd59f8 0xf4240>;
			opp-microvolt-L3 = <0xcf850 0xcf850 0xf4240>;
			opp-microvolt-L1 = <0xcf850 0xcf850 0xf4240>;
		};

		opp-900000000 {
			opp-microvolt = <0xee098 0xee098 0xf4240>;
			opp-microvolt-L2 = <0xe1d48 0xe1d48 0xf4240>;
			opp-hz = <0x00 0x35a4e900>;
			opp-microvolt-L0 = <0xee098 0xee098 0xf4240>;
			opp-microvolt-L3 = <0xdbba0 0xdbba0 0xf4240>;
			opp-microvolt-L1 = <0xe7ef0 0xe7ef0 0xf4240>;
		};

		opp-200000000 {
			opp-microvolt = <0xcf850 0xcf850 0xf4240>;
			opp-hz = <0x00 0xbebc200>;
		};

		opp-400000000 {
			opp-microvolt = <0xcf850 0xcf850 0xf4240>;
			opp-hz = <0x00 0x17d78400>;
		};

		opp-600000000 {
			opp-microvolt = <0xcf850 0xcf850 0xf4240>;
			opp-hz = <0x00 0x23c34600>;
		};

		opp-1000000000 {
			opp-microvolt = <0xf4240 0xf4240 0xf4240>;
			opp-microvolt-L2 = <0xe7ef0 0xe7ef0 0xf4240>;
			opp-hz = <0x00 0x3b9aca00>;
			opp-microvolt-L0 = <0xf4240 0xf4240 0xf4240>;
			status = "disabled";
			opp-microvolt-L3 = <0xe1d48 0xe1d48 0xf4240>;
			opp-microvolt-L1 = <0xee098 0xee098 0xf4240>;
		};

		opp-800000000 {
			opp-microvolt = <0xe1d48 0xe1d48 0xf4240>;
			opp-microvolt-L2 = <0xd59f8 0xd59f8 0xf4240>;
			opp-hz = <0x00 0x2faf0800>;
			opp-microvolt-L0 = <0xe1d48 0xe1d48 0xf4240>;
			opp-microvolt-L3 = <0xd59f8 0xd59f8 0xf4240>;
			opp-microvolt-L1 = <0xdbba0 0xdbba0 0xf4240>;
		};
	};

	dwmmc@fe2b0000 {
		supports-sd;
		fifo-depth = <0x100>;
		pinctrl-names = "default";
		pinctrl-0 = <0xbd 0xbe 0xbf 0xc0>;
		clock-names = "biu\0ciu\0ciu-drive\0ciu-sample";
		cap-sd-highspeed;
		vqmmc-supply = <0x2d>;
		bus-width = <0x04>;
		resets = <0x20 0xd4>;
		interrupts = <0x00 0x62 0x04>;
		clocks = <0x20 0xb0 0x20 0xb1 0x20 0x18a 0x20 0x18b>;
		vmmc-supply = <0xbc>;
		compatible = "rockchip,rk3568-dw-mshc\0rockchip,rk3288-dw-mshc";
		status = "okay";
		disable-wp;
		reg = <0x00 0xfe2b0000 0x00 0x4000>;
		sd-uhs-sdr104;
		max-frequency = <0x8f0d180>;
		cap-mmc-highspeed;
		reset-names = "reset";
	};

	i2c@fe5a0000 {
		pinctrl-names = "default";
		#address-cells = <0x01>;
		pinctrl-0 = <0xd8>;
		clock-names = "i2c\0pclk";
		interrupts = <0x00 0x2f 0x04>;
		clocks = <0x20 0x148 0x20 0x147>;
		#size-cells = <0x00>;
		compatible = "rockchip,rk3399-i2c";
		status = "disabled";
		reg = <0x00 0xfe5a0000 0x00 0x1000>;
	};

	codec-digital@fe478000 {
		pinctrl-names = "default";
		pinctrl-0 = <0xd6>;
		clock-names = "adc\0dac\0i2c\0pclk";
		resets = <0x20 0x5f>;
		clocks = <0x20 0x67 0x20 0x66 0x20 0x65 0x20 0x64>;
		#sound-dai-cells = <0x00>;
		compatible = "rockchip,rk3568-codec-digital\0rockchip,codec-digital-v1";
		status = "disabled";
		rockchip,grf = <0x34>;
		reg = <0x00 0xfe478000 0x00 0x1000>;
		reset-names = "reset";
	};

	spi@fe640000 {
		pinctrl-names = "default\0high_speed";
		#address-cells = <0x01>;
		num-cs = <0x02>;
		pinctrl-0 = <0xe9 0xea 0xeb>;
		clock-names = "spiclk\0apb_pclk";
		interrupts = <0x00 0x6a 0x04>;
		clocks = <0x20 0x158 0x20 0x157>;
		#size-cells = <0x00>;
		dma-names = "tx\0rx";
		compatible = "rockchip,rk3066-spi";
		pinctrl-1 = <0xe9 0xea 0xec>;
		status = "disabled";
		reg = <0x00 0xfe640000 0x00 0x1000>;
		dmas = <0x40 0x1a 0x40 0x1b>;
	};

	ddr4-params {
		dram_dq_drv_odten = <0x22>;
		reserved = <0x00>;
		phy_dll_dis_freq = <0x00>;
		pd_dis_freq = <0x42a>;
		phy_clk_drv_odtoff = <0x25>;
		phy_odt_puup_en = <0x01>;
		dram_odt = <0x78>;
		standby_idle = <0x00>;
		dq_map_cs0_dq_l = <0x22777788>;
		dram_dq_drv_odtoff = <0x22>;
		phy_dq_sr_odten = <0x0e>;
		speed_bin = <0x0c>;
		dq_map_cs1_dq_h = <0xd7888877>;
		freq_4 = <0x00>;
		sr_dis_freq = <0x320>;
		dram_dq_odt_en_freq = <0x1f4>;
		phy_clk_sr_odtoff = <0x01>;
		freq_2 = <0x210>;
		phy_clk_drv_odten = <0x25>;
		phy_dq_drv_odtoff = <0x25>;
		dq_map_cs0_dq_h = <0xd7888877>;
		phy_ca_sr_odten = <0x01>;
		sr_idle = <0x5d>;
		ssmod_div = <0x00>;
		freq_0 = <0x420>;
		phy_clk_sr_odten = <0x01>;
		phy_odt = <0x8b>;
		phy_dq_sr_odtoff = <0x0e>;
		phy_dq_drv_odten = <0x25>;
		phy_odt_en_freq = <0x1f4>;
		sr_mc_gate_idle = <0x00>;
		pd_idle = <0x0d>;
		dram_dll_dis_freq = <0x271>;
		ssmod_downspread = <0x00>;
		phy_odt_pudn_en = <0x01>;
		freq_5 = <0x00>;
		ssmod_spread = <0x00>;
		freq_3 = <0x30c>;
		phandle = <0xa6>;
		expanded_version = <0x00>;
		phy_ca_drv_odtoff = <0x25>;
		version = <0x100>;
		dram_ext_temp = <0x00>;
		phy_ca_sr_odtoff = <0x01>;
		freq_1 = <0x144>;
		phy_ca_drv_odten = <0x25>;
		mode_2t = <0x00>;
		srpd_lite_idle = <0x00>;
		byte_map = <0xe4>;
		dq_map_cs1_dq_l = <0x22777788>;
	};

	i2c@fe5e0000 {
		pinctrl-names = "default";
		#address-cells = <0x01>;
		pinctrl-0 = <0xdc>;
		clock-names = "i2c\0pclk";
		i2c-scl-rising-time-ns = <0xa0>;
		i2c-scl-falling-time-ns = <0x1e>;
		interrupts = <0x00 0x33 0x04>;
		clocks = <0x20 0x150 0x20 0x14f>;
		#size-cells = <0x00>;
		clock-frequency = <0x61a80>;
		compatible = "rockchip,rk3399-i2c";
		status = "okay";
		reg = <0x00 0xfe5e0000 0x00 0x1000>;
	};

	dsi@fe060000 {
		power-domains = <0x22 0x09>;
		#address-cells = <0x01>;
		phy-names = "dphy";
		clock-names = "pclk\0hclk";
		resets = <0x20 0x110>;
		interrupts = <0x00 0x44 0x04>;
		clocks = <0x20 0xe8 0x20 0xda>;
		#size-cells = <0x00>;
		compatible = "rockchip,rk3568-mipi-dsi";
		status = "disabled";
		rockchip,grf = <0x34>;
		phys = <0x30>;
		reg = <0x00 0xfe060000 0x00 0x10000>;
		reset-names = "apb";

		ports {
			#address-cells = <0x01>;
			#size-cells = <0x00>;

			port@0 {
				#address-cells = <0x01>;
				#size-cells = <0x00>;
				reg = <0x00>;

				endpoint@1 {
					remote-endpoint = <0x95>;
					status = "disabled";
					reg = <0x01>;
					phandle = <0x8e>;
				};

				endpoint@0 {
					remote-endpoint = <0x15>;
					status = "disabled";
					reg = <0x00>;
					phandle = <0x8a>;
				};
			};
		};
	};

	iommu@fdff1a00 {
		power-domains = <0x22 0x08>;
		clock-names = "aclk\0iface";
		interrupts = <0x00 0x3b 0x04>;
		clocks = <0x20 0xd2 0x20 0xd3>;
		#iommu-cells = <0x00>;
		compatible = "rockchip,iommu-v2";
		rockchip,disable-mmu-reset;
		status = "disabled";
		interrupt-names = "isp_mmu";
		reg = <0x00 0xfdff1a00 0x00 0x100>;
		phandle = <0x7c>;
	};

	qos@fe190380 {
		compatible = "syscon";
		reg = <0x00 0xfe190380 0x00 0x20>;
		phandle = <0x5f>;
	};

	vcc3v3-sys {
		regulator-max-microvolt = <0x325aa0>;
		pinctrl-names = "default";
		regulator-boot-on;
		gpio = <0x38 0x0e 0x00>;
		pinctrl-0 = <0x127>;
		regulator-always-on;
		enable-active-high;
		regulator-min-microvolt = <0x325aa0>;
		regulator-name = "vcc3v3_sys";
		compatible = "regulator-fixed";
		phandle = <0x37>;
		vin-supply = <0x128>;
	};

	mipi-csi2@fdfb0000 {
		clock-names = "pclk_csi2host";
		reg-names = "csihost_regs";
		resets = <0x20 0xff>;
		interrupts = <0x00 0x08 0x04 0x00 0x09 0x04>;
		clocks = <0x20 0xd5>;
		compatible = "rockchip,rk3568-mipi-csi2";
		status = "disabled";
		interrupt-names = "csi-intr1\0csi-intr2";
		reg = <0x00 0xfdfb0000 0x00 0x10000>;
		reset-names = "srst_csihost_p";
	};

	rkvdec@fdf80200 {
		power-domains = <0x22 0x0d>;
		iommus = <0x75>;
		rockchip,advanced-rates = <0x179a7b00 0x00 0x179a7b00 0x179a7b00 0x23c34600>;
		clock-names = "aclk_vcodec\0hclk_vcodec\0clk_cabac\0clk_core\0clk_hevc_cabac";
		reg-names = "regs\0link";
		assigned-clocks = <0x20 0x108 0x20 0x10a 0x20 0x10b 0x20 0x10c>;
		rockchip,task-capacity = <0x10>;
		rockchip,normal-rates = <0x11b3dc40 0x00 0x11b3dc40 0x11b3dc40 0x23c34600>;
		assigned-clock-rates = <0x11b3dc40 0x11b3dc40 0x11b3dc40 0x11b3dc40>;
		resets = <0x20 0x142 0x20 0x143 0x20 0x144 0x20 0x145 0x20 0x146>;
		interrupts = <0x00 0x5b 0x04>;
		clocks = <0x20 0x108 0x20 0x109 0x20 0x10a 0x20 0x10b 0x20 0x10c>;
		rockchip,rcb-min-width = <0x200>;
		rockchip,srv = <0x6d>;
		rockchip,taskqueue-node = <0x04>;
		compatible = "rockchip,rkv-decoder-rk3568\0rockchip,rkv-decoder-v2";
		rockchip,resetgroup-node = <0x04>;
		status = "okay";
		interrupt-names = "irq_dec";
		rockchip,rcb-iova = <0x10000000 0x10000>;
		reg = <0x00 0xfdf80200 0x00 0x400 0x00 0xfdf80100 0x00 0x100>;
		reset-names = "video_a\0video_h\0video_cabac\0video_core\0video_hevc_cabac";
		operating-points-v2 = <0x74>;
		vdec-supply = <0x67>;
		rockchip,sram = <0x76>;
		rockchip,default-max-load = <0x1fe000>;
	};

	mpp-srv {
		rockchip,resetgroup-count = <0x06>;
		rockchip,taskqueue-count = <0x06>;
		compatible = "rockchip,mpp-service";
		status = "okay";
		phandle = <0x6d>;
	};

	syscon@fdc80000 {
		compatible = "rockchip,pipe-phy-grf\0syscon";
		reg = <0x00 0xfdc80000 0x00 0x1000>;
		phandle = <0x10d>;
	};

	timer {
		arm,no-tick-in-suspend;
		interrupts = <0x01 0x0d 0xf04 0x01 0x0e 0xf04 0x01 0x0b 0xf04 0x01 0x0a 0xf04>;
		compatible = "arm,armv8-timer";
	};

	rockchip-suspend {
		rockchip,sleep-debug-en = <0x01>;
		rockchip,sleep-mode-config = <0x5ec>;
		compatible = "rockchip,pm-rk3568";
		status = "okay";
		rockchip,wakeup-config = <0x10>;
	};

	phy@fe8c0000 {
		clock-names = "refclk_m\0refclk_n\0pclk";
		resets = <0x20 0x1be>;
		clocks = <0x33 0x26 0x33 0x27 0x20 0x177>;
		#phy-cells = <0x00>;
		compatible = "rockchip,rk3568-pcie3-phy";
		status = "okay";
		reg = <0x00 0xfe8c0000 0x00 0x20000>;
		phandle = <0xb0>;
		reset-names = "phy";
		rockchip,phy-grf = <0x113>;
	};

	iommu@fded0480 {
		power-domains = <0x22 0x0a>;
		clock-names = "aclk\0iface";
		interrupts = <0x00 0x3d 0x04>;
		clocks = <0x20 0xfb 0x20 0xfc>;
		#iommu-cells = <0x00>;
		compatible = "rockchip,iommu-v2";
		status = "okay";
		interrupt-names = "jpegd_mmu";
		reg = <0x00 0xfded0480 0x00 0x40>;
		phandle = <0x6f>;
	};

	i2s@fe410000 {
		pinctrl-names = "default";
		rockchip,cru = <0x20>;
		pinctrl-0 = <0xc2 0xc3 0xc4 0xc5>;
		clock-names = "mclk_tx\0mclk_rx\0hclk";
		resets = <0x20 0x52 0x20 0x53>;
		interrupts = <0x00 0x35 0x04>;
		clocks = <0x20 0x47 0x20 0x4b 0x20 0x3a>;
		dma-names = "tx\0rx";
		#sound-dai-cells = <0x00>;
		compatible = "rockchip,rk3568-i2s-tdm";
		status = "disabled";
		rockchip,grf = <0x34>;
		reg = <0x00 0xfe410000 0x00 0x1000>;
		phandle = <0xd4>;
		dmas = <0xc1 0x02 0xc1 0x03>;
		reset-names = "tx-m\0rx-m";
		rockchip,clk-trcm = <0x01>;
	};

	sdio-pwrseq {
		pinctrl-names = "default";
		pinctrl-0 = <0x12c>;
		clock-names = "ext_clock";
		clocks = <0x12b 0x01>;
		reset-gpios = <0xae 0x1d 0x01>;
		compatible = "mmc-pwrseq-simple";
		post-power-on-delay-ms = <0xc8>;
		status = "okay";
		phandle = <0x9e>;
	};

	rkvdec-opp-table {
		rockchip,pvtm-ch = <0x00 0x05>;
		nvmem-cells = <0x77 0x07>;
		rockchip,leakage-voltage-sel = <0x01 0x50 0x00 0x51 0xfe 0x01>;
		compatible = "operating-points-v2";
		nvmem-cell-names = "leakage\0pvtm";
		rockchip,pvtm-voltage-sel = <0x00 0x14820 0x00 0x14821 0x186a0 0x01>;
		phandle = <0x74>;

		opp-400000000 {
			opp-microvolt = <0xdbba0>;
			opp-hz = <0x00 0x17d78400>;
		};

		opp-297000000 {
			opp-microvolt = <0xdbba0>;
			opp-hz = <0x00 0x11b3dc40>;
			opp-microvolt-L0 = <0xdbba0>;
			opp-microvolt-L1 = <0xd59f8>;
		};
	};

	bus-npu-opp-table {
		rockchip,pvtm-ch = <0x00 0x05>;
		nvmem-cells = <0x07>;
		opp-shared;
		compatible = "operating-points-v2";
		nvmem-cell-names = "pvtm";
		rockchip,pvtm-voltage-sel = <0x00 0x14820 0x00 0x14821 0x16378 0x01 0x16379 0x186a0 0x02>;
		phandle = <0x66>;

		opp-700000000 {
			opp-microvolt = <0xdbba0>;
			opp-microvolt-L2 = <0xd59f8>;
			opp-hz = <0x00 0x29b92700>;
			opp-microvolt-L0 = <0xdbba0>;
			opp-microvolt-L1 = <0xd59f8>;
		};

		opp-900000000 {
			opp-microvolt = <0xdbba0>;
			opp-hz = <0x00 0x35a4e900>;
		};

		opp-1000000000 {
			opp-microvolt = <0xe7ef0>;
			opp-microvolt-L2 = <0xdbba0>;
			opp-hz = <0x00 0x3b9aca00>;
			opp-microvolt-L0 = <0xe7ef0>;
			opp-microvolt-L1 = <0xe1d48>;
		};
	};

	sram@fdcc0000 {
		#address-cells = <0x01>;
		#size-cells = <0x01>;
		compatible = "mmio-sram";
		ranges = <0x00 0x00 0xfdcc0000 0xb000>;
		reg = <0x00 0xfdcc0000 0x00 0xb000>;

		rkvdec-sram@0 {
			reg = <0x00 0xb000>;
			phandle = <0x76>;
		};
	};

	pwm@fe6e0030 {
		pinctrl-names = "default";
		remote_support_psci = <0x00>;
		pinctrl-0 = <0xf9>;
		clock-names = "pwm\0pclk";
		interrupts = <0x00 0x53 0x04 0x00 0x57 0x04>;
		clocks = <0x20 0x15a 0x20 0x159>;
		handle_cpu_id = <0x01>;
		#pwm-cells = <0x03>;
		compatible = "rockchip,remotectl-pwm";
		status = "disabled";
		remote_pwm_id = <0x03>;
		reg = <0x00 0xfe6e0030 0x00 0x10>;
	};

	serial@fe6c0000 {
		reg-io-width = <0x04>;
		pinctrl-names = "default";
		pinctrl-0 = <0xf4>;
		clock-names = "baudclk\0apb_pclk";
		interrupts = <0x00 0x7c 0x04>;
		clocks = <0x20 0x13b 0x20 0x138>;
		compatible = "rockchip,rk3568-uart\0snps,dw-apb-uart";
		status = "disabled";
		reg = <0x00 0xfe6c0000 0x00 0x100>;
		dmas = <0x40 0x10 0x40 0x11>;
		reg-shift = <0x02>;
	};

	sata@fc800000 {
		power-domains = <0x22 0x0f>;
		phy-names = "sata-phy";
		clock-names = "sata\0pmalive\0rxoob";
		interrupts = <0x00 0x60 0x04>;
		clocks = <0x20 0xa0 0x20 0xa1 0x20 0xa2>;
		compatible = "snps,dwc-ahci";
		status = "disabled";
		interrupt-names = "hostc";
		phys = <0x24 0x01>;
		reg = <0x00 0xfc800000 0x00 0x1000>;
		ports-implemented = <0x01>;
	};

	usb@fd8c0000 {
		phy-names = "usb2-phy";
		clock-names = "usbhost\0arbiter\0pclk\0utmi";
		interrupts = <0x00 0x86 0x04>;
		clocks = <0x20 0xbf 0x20 0xc0 0x20 0xbc 0x28>;
		compatible = "generic-ohci";
		status = "okay";
		phys = <0x2a>;
		reg = <0x00 0xfd8c0000 0x00 0x40000>;
	};

	qos@fe158100 {
		compatible = "syscon";
		reg = <0x00 0xfe158100 0x00 0x20>;
		phandle = <0x4f>;
	};

	pvtm@fde00000 {
		#address-cells = <0x01>;
		#size-cells = <0x00>;
		compatible = "rockchip,rk3568-core-pvtm";
		reg = <0x00 0xfde00000 0x00 0x100>;

		pvtm@0 {
			clock-names = "clk\0pclk";
			thermal-zone = "soc-thermal";
			resets = <0x20 0x1a 0x20 0x19>;
			clocks = <0x20 0x13 0x20 0x1c2>;
			reg = <0x00>;
			reset-names = "rts\0rst-p";
		};
	};

	pwm@fe6e0020 {
		pinctrl-names = "active";
		pinctrl-0 = <0xf8>;
		clock-names = "pwm\0pclk";
		clocks = <0x20 0x15a 0x20 0x159>;
		#pwm-cells = <0x03>;
		compatible = "rockchip,rk3568-pwm\0rockchip,rk3328-pwm";
		status = "disabled";
		reg = <0x00 0xfe6e0020 0x00 0x10>;
	};

	cpuinfo {
		nvmem-cells = <0x0e 0x0f 0x10>;
		compatible = "rockchip,cpuinfo";
		nvmem-cell-names = "id\0cpu-version\0cpu-code";
	};

	qos@fe150000 {
		compatible = "syscon";
		reg = <0x00 0xfe150000 0x00 0x20>;
		phandle = <0x54>;
	};

	phy@fe850000 {
		power-domains = <0x22 0x09>;
		clock-names = "ref\0pclk\0pclk_host";
		reg-names = "phy\0host";
		resets = <0x20 0x1bb>;
		clocks = <0x33 0x17 0x20 0x17a 0x20 0xe8>;
		#clock-cells = <0x00>;
		#phy-cells = <0x00>;
		compatible = "rockchip,rk3568-dsi-dphy\0rockchip,rk3568-video-phy";
		status = "disabled";
		reg = <0x00 0xfe850000 0x00 0x10000 0x00 0xfe060000 0x00 0x10000>;
		phandle = <0x30>;
		reset-names = "apb";
	};

	lpddr3-params {
		dram_dq_drv_odten = <0x22>;
		reserved = <0x00>;
		phy_dll_dis_freq = <0x00>;
		pd_dis_freq = <0x42a>;
		phy_clk_drv_odtoff = <0x27>;
		phy_odt_puup_en = <0x01>;
		dram_odt = <0x78>;
		standby_idle = <0x00>;
		dq_map_cs0_dq_l = <0x00>;
		dram_dq_drv_odtoff = <0x22>;
		phy_dq_sr_odten = <0x0f>;
		speed_bin = <0x00>;
		dq_map_cs1_dq_h = <0x00>;
		freq_4 = <0x00>;
		sr_dis_freq = <0x320>;
		dram_dq_odt_en_freq = <0x14d>;
		phy_clk_sr_odtoff = <0x0f>;
		freq_2 = <0x210>;
		phy_clk_drv_odten = <0x27>;
		phy_dq_drv_odtoff = <0x25>;
		dq_map_cs0_dq_h = <0x00>;
		phy_ca_sr_odten = <0x01>;
		sr_idle = <0x5d>;
		ssmod_div = <0x00>;
		freq_0 = <0x420>;
		phy_clk_sr_odten = <0x0f>;
		phy_odt = <0x94>;
		phy_dq_sr_odtoff = <0x0f>;
		phy_dq_drv_odten = <0x25>;
		phy_odt_en_freq = <0x14d>;
		sr_mc_gate_idle = <0x00>;
		pd_idle = <0x0d>;
		dram_dll_dis_freq = <0x00>;
		ssmod_downspread = <0x00>;
		phy_odt_pudn_en = <0x01>;
		freq_5 = <0x00>;
		ssmod_spread = <0x00>;
		freq_3 = <0x30c>;
		phandle = <0xa7>;
		expanded_version = <0x00>;
		phy_ca_drv_odtoff = <0x25>;
		version = <0x100>;
		dram_ext_temp = <0x00>;
		phy_ca_sr_odtoff = <0x01>;
		freq_1 = <0x144>;
		phy_ca_drv_odten = <0x25>;
		mode_2t = <0x00>;
		srpd_lite_idle = <0x00>;
		byte_map = <0x8d>;
		dq_map_cs1_dq_l = <0x00>;
	};

	aliases {
		i2c3 = "/i2c@fe5c0000";
		ethernet0 = "/ethernet@fe2a0000";
		spi2 = "/spi@fe630000";
		gpio0 = "/pinctrl/gpio0@fdd60000";
		dsi1 = "/dsi@fe070000";
		serial7 = "/serial@fe6b0000";
		i2c1 = "/i2c@fe5a0000";
		mmc3 = "/dwmmc@fe000000";
		spi0 = "/spi@fe610000";
		serial5 = "/serial@fe690000";
		mmc1 = "/sdhci@fe310000";
		serial3 = "/serial@fe670000";
		led-boot = "/leds/green";
		csi2dphy1 = "/csi2-dphy1";
		serial1 = "/serial@fe650000";
		gpio3 = "/pinctrl/gpio3@fe760000";
		i2c4 = "/i2c@fe5d0000";
		ethernet1 = "/ethernet@fe010000";
		led-upgrade = "/leds/green";
		spi3 = "/spi@fe640000";
		led-running = "/leds/green";
		gpio1 = "/pinctrl/gpio1@fe740000";
		serial8 = "/serial@fe6c0000";
		i2c2 = "/i2c@fe5b0000";
		spi1 = "/spi@fe620000";
		dsi0 = "/dsi@fe060000";
		serial6 = "/serial@fe6a0000";
		i2c0 = "/i2c@fdd40000";
		led-failsafe = "/leds/green";
		mmc2 = "/dwmmc@fe2c0000";
		serial4 = "/serial@fe680000";
		mmc0 = "/dwmmc@fe2b0000";
		csi2dphy2 = "/csi2-dphy2";
		serial2 = "/serial@fe660000";
		gpio4 = "/pinctrl/gpio4@fe770000";
		i2c5 = "/i2c@fe5e0000";
		csi2dphy0 = "/csi2-dphy0";
		serial0 = "/serial@fdd50000";
		gpio2 = "/pinctrl/gpio2@fe750000";
		serial9 = "/serial@fe6d0000";
	};

	pwm@fe6e0010 {
		pinctrl-names = "active";
		pinctrl-0 = <0xf7>;
		clock-names = "pwm\0pclk";
		clocks = <0x20 0x15a 0x20 0x159>;
		#pwm-cells = <0x03>;
		compatible = "rockchip,rk3568-pwm\0rockchip,rk3328-pwm";
		status = "disabled";
		reg = <0x00 0xfe6e0010 0x00 0x10>;
	};

	qos@fe148000 {
		compatible = "syscon";
		reg = <0x00 0xfe148000 0x00 0x20>;
		phandle = <0x48>;
	};

	nandc@fe330000 {
		#address-cells = <0x01>;
		clock-names = "clk_nandc\0hclk_nandc";
		nandc_id = <0x00>;
		interrupts = <0x00 0x46 0x04>;
		clocks = <0x20 0x75 0x20 0x74>;
		#size-cells = <0x00>;
		compatible = "rockchip,rk-nandc-v9";
		status = "disabled";
		reg = <0x00 0xfe330000 0x00 0x4000>;

		nand@0 {
			nand-ecc-step-size = <0x400>;
			reg = <0x00>;
			nand-ecc-mode = "hw";
			nand-ecc-strength = <0x10>;
			nand-bus-width = <0x08>;
		};
	};

	firmware {

		optee {
			method = "smc";
			compatible = "linaro,optee-tz";
		};

		sdei {
			method = "smc";
			compatible = "arm,sdei-1.0";
		};

		scmi {
			shmem = <0x1b>;
			#address-cells = <0x01>;
			#size-cells = <0x00>;
			compatible = "arm,scmi-smc";
			arm,smc-id = <0x82000010>;

			protocol@14 {
				#clock-cells = <0x01>;
				reg = <0x14>;
				rockchip,clk-init = <0x41cdb400>;
				phandle = <0x02>;
			};
		};
	};

	serial@fe650000 {
		reg-io-width = <0x04>;
		pinctrl-names = "default";
		pinctrl-0 = <0xed>;
		clock-names = "baudclk\0apb_pclk";
		interrupts = <0x00 0x75 0x04>;
		clocks = <0x20 0x11f 0x20 0x11c>;
		compatible = "rockchip,rk3568-uart\0snps,dw-apb-uart";
		status = "disabled";
		reg = <0x00 0xfe650000 0x00 0x100>;
		dmas = <0x40 0x02 0x40 0x03>;
		reg-shift = <0x02>;
	};

	rk809-sound {
		simple-audio-card,name = "rockchip,rk809-codec";
		simple-audio-card,format = "i2s";
		compatible = "simple-audio-card";
		status = "okay";
		simple-audio-card,mclk-fs = <0x100>;

		simple-audio-card,cpu {
			sound-dai = <0xd4>;
		};

		simple-audio-card,codec {
			sound-dai = <0x123 0x00>;
		};
	};

	qos@fe190000 {
		compatible = "syscon";
		reg = <0x00 0xfe190000 0x00 0x20>;
		phandle = <0x59>;
	};

	debug@fd904000 {
		compatible = "rockchip,debug";
		reg = <0x00 0xfd904000 0x00 0x1000 0x00 0xfd905000 0x00 0x1000 0x00 0xfd906000 0x00 0x1000 0x00 0xfd907000 0x00 0x1000>;
	};

	ebc@fdec0000 {
		power-domains = <0x22 0x0a>;
		pinctrl-names = "default";
		pinctrl-0 = <0x6e>;
		clock-names = "hclk\0dclk";
		interrupts = <0x00 0x11 0x04>;
		clocks = <0x20 0xf9 0x20 0xfa>;
		compatible = "rockchip,rk3568-ebc-tcon";
		status = "disabled";
		rockchip,grf = <0x34>;
		reg = <0x00 0xfdec0000 0x00 0x5000>;
	};

	pwm@fe6e0000 {
		pinctrl-names = "active";
		pinctrl-0 = <0xf6>;
		clock-names = "pwm\0pclk";
		clocks = <0x20 0x15a 0x20 0x159>;
		#pwm-cells = <0x03>;
		compatible = "rockchip,rk3568-pwm\0rockchip,rk3328-pwm";
		status = "disabled";
		reg = <0x00 0xfe6e0000 0x00 0x10>;
	};

	iommu@fdfe0800 {
		power-domains = <0x22 0x08>;
		clock-names = "aclk\0iface";
		interrupts = <0x00 0x92 0x04>;
		clocks = <0x20 0xce 0x20 0xcf>;
		#iommu-cells = <0x00>;
		compatible = "rockchip,iommu-v2";
		rockchip,disable-mmu-reset;
		status = "disabled";
		interrupt-names = "cif_mmu";
		reg = <0x00 0xfdfe0800 0x00 0x100>;
		phandle = <0x78>;
	};

	mpll {
		clock-output-names = "mpll";
		#clock-cells = <0x00>;
		clock-frequency = <0x2faf0800>;
		compatible = "fixed-clock";
	};

	vcc5v0-otg-regulator {
		regulator-max-microvolt = <0x4c4b40>;
		pinctrl-names = "default";
		gpio = <0x38 0x05 0x00>;
		pinctrl-0 = <0x129>;
		enable-active-high;
		regulator-min-microvolt = <0x4c4b40>;
		regulator-name = "vcc5v0_otg";
		compatible = "regulator-fixed";
		phandle = <0x111>;
		vin-supply = <0x128>;
	};

	usbdrd {
		#address-cells = <0x02>;
		clock-names = "ref_clk\0suspend_clk\0bus_clk\0pipe_clk";
		clocks = <0x20 0xa6 0x20 0xa7 0x20 0xa5 0x20 0x7f>;
		#size-cells = <0x02>;
		compatible = "rockchip,rk3568-dwc3\0rockchip,rk3399-dwc3";
		ranges;
		status = "disabled";

		dwc3@fcc00000 {
			power-domains = <0x22 0x0f>;
			snps,dis-u1-entry-quirk;
			snps,dis_enblslpm_quirk;
			phy-names = "usb2-phy";
			snps,dis-u2-freeclk-exists-quirk;
			phy_type = "utmi_wide";
			quirk-skip-phy-init;
			snps,dis_u2_susphy_quirk;
			resets = <0x20 0x94>;
			interrupts = <0x00 0xa9 0x04>;
			snps,dis_rxdet_inp3_quirk;
			extcon = <0x26>;
			snps,dis-u2-entry-quirk;
			compatible = "snps,dwc3";
			snps,dis-del-phy-power-chg-quirk;
			status = "disabled";
			snps,xhci-trb-ent-quirk;
			snps,parkmode-disable-ss-quirk;
			phys = <0x25>;
			reg = <0x00 0xfcc00000 0x00 0x400000>;
			dr_mode = "host";
			maximum-speed = "high-speed";
			reset-names = "usb3-otg";
			snps,dis-tx-ipgap-linecheck-quirk;
		};
	};

	pvtm@fde80000 {
		#address-cells = <0x01>;
		#size-cells = <0x00>;
		compatible = "rockchip,rk3568-gpu-pvtm";
		reg = <0x00 0xfde80000 0x00 0x100>;

		pvtm@1 {
			clock-names = "clk\0pclk";
			thermal-zone = "gpu-thermal";
			resets = <0x20 0x24 0x20 0x23>;
			clocks = <0x20 0x1e 0x20 0x1d>;
			reg = <0x01>;
			reset-names = "rts\0rst-p";
		};
	};

	lpddr4-params {
		dram_dq_drv_odten = <0x28>;
		reserved = <0x00>;
		phy_dll_dis_freq = <0x00>;
		pd_dis_freq = <0x42a>;
		phy_clk_drv_odtoff = <0x26>;
		phy_odt_puup_en = <0x00>;
		dram_odt = <0x50>;
		standby_idle = <0x00>;
		dq_map_cs0_dq_l = <0x00>;
		dram_dq_drv_odtoff = <0x28>;
		phy_dq_sr_odten = <0x00>;
		lp4_ca_odt_en_freq = <0x320>;
		speed_bin = <0x00>;
		dq_map_cs1_dq_h = <0x00>;
		freq_4 = <0x00>;
		sr_dis_freq = <0x320>;
		dram_dq_odt_en_freq = <0x320>;
		phy_clk_sr_odtoff = <0x0f>;
		phy_lp4_cs_drv_odten = <0x00>;
		freq_2 = <0x210>;
		phy_clk_drv_odten = <0x26>;
		phy_dq_drv_odtoff = <0x1e>;
		dq_map_cs0_dq_h = <0x00>;
		phy_lp4_drv_pulldown_en_odten = <0x00>;
		lp4_drv_pu_cal_odten = <0x01>;
		phy_ca_sr_odten = <0x0f>;
		sr_idle = <0x5d>;
		phy_lp4_drv_pulldown_en_odtoff = <0x00>;
		ssmod_div = <0x00>;
		freq_0 = <0x618>;
		phy_clk_sr_odten = <0x0f>;
		phy_odt = <0x3c>;
		phy_dq_sr_odtoff = <0x00>;
		lp4_dq_vref_odten = <0x12c>;
		lp4_ca_odt = <0x78>;
		phy_dq_drv_odten = <0x1e>;
		phy_lp4_dq_vref_odten = <0xa6>;
		phy_odt_en_freq = <0x320>;
		sr_mc_gate_idle = <0x00>;
		pd_idle = <0x0d>;
		lp4_dq_vref_odtoff = <0x1a4>;
		dram_dll_dis_freq = <0x00>;
		ssmod_downspread = <0x00>;
		phy_odt_pudn_en = <0x00>;
		freq_5 = <0x00>;
		ssmod_spread = <0x00>;
		phy_lp4_dq_vref_odtoff = <0x1a4>;
		phy_lp4_cs_drv_odtoff = <0x00>;
		lp4_ca_vref_odtoff = <0x1a4>;
		freq_3 = <0x30c>;
		lp4_drv_pu_cal_odtoff = <0x01>;
		phandle = <0xa8>;
		expanded_version = <0x00>;
		phy_ca_drv_odtoff = <0x26>;
		lp4_odte_ck_en = <0x01>;
		lp4_odte_cs_en = <0x01>;
		version = <0x100>;
		dram_ext_temp = <0x00>;
		phy_ca_sr_odtoff = <0x0f>;
		freq_1 = <0x144>;
		lp4_ca_vref_odten = <0x17c>;
		phy_ca_drv_odten = <0x26>;
		lp4_odtd_ca_en = <0x00>;
		mode_2t = <0x00>;
		srpd_lite_idle = <0x00>;
		byte_map = <0xe4>;
		dq_map_cs1_dq_l = <0x00>;
	};

	pwm@fe700030 {
		pinctrl-names = "active";
		pinctrl-0 = <0x101>;
		clock-names = "pwm\0pclk";
		interrupts = <0x00 0x55 0x04 0x00 0x59 0x04>;
		clocks = <0x20 0x160 0x20 0x15f>;
		#pwm-cells = <0x03>;
		compatible = "rockchip,rk3568-pwm\0rockchip,rk3328-pwm";
		status = "disabled";
		reg = <0x00 0xfe700030 0x00 0x10>;
	};

	serial@fe690000 {
		reg-io-width = <0x04>;
		pinctrl-names = "default";
		pinctrl-0 = <0xf1>;
		clock-names = "baudclk\0apb_pclk";
		interrupts = <0x00 0x79 0x04>;
		clocks = <0x20 0x12f 0x20 0x12c>;
		compatible = "rockchip,rk3568-uart\0snps,dw-apb-uart";
		status = "disabled";
		reg = <0x00 0xfe690000 0x00 0x100>;
		dmas = <0x40 0x0a 0x40 0x0b>;
		reg-shift = <0x02>;
	};

	can@fe570000 {
		clock-names = "baudclk\0apb_pclk";
		resets = <0x20 0x155 0x20 0x154>;
		interrupts = <0x00 0x01 0x04>;
		clocks = <0x20 0x141 0x20 0x140>;
		compatible = "rockchip,rk3568-can-2.0";
		status = "disabled";
		tx-fifo-depth = <0x01>;
		rx-fifo-depth = <0x06>;
		reg = <0x00 0xfe570000 0x00 0x1000>;
		reset-names = "can\0can-apb";
	};

	pcie@fe260000 {
		power-domains = <0x22 0x0f>;
		vpcie3v3-supply = <0xad>;
		#address-cells = <0x03>;
		phy-names = "pcie-phy";
		bus-range = <0x00 0x0f>;
		clock-names = "aclk_mst\0aclk_slv\0aclk_dbi\0pclk\0aux";
		reg-names = "pcie-dbi\0pcie-apb";
		num-ob-windows = <0x02>;
		resets = <0x20 0xa1>;
		interrupts = <0x00 0x4b 0x04 0x00 0x4a 0x04 0x00 0x49 0x04 0x00 0x48 0x04 0x00 0x47 0x04>;
		clocks = <0x20 0x81 0x20 0x82 0x20 0x83 0x20 0x84 0x20 0x85>;
		interrupt-map = <0x00 0x00 0x00 0x01 0xab 0x00 0x00 0x00 0x00 0x02 0xab 0x01 0x00 0x00 0x00 0x03 0xab 0x02 0x00 0x00 0x00 0x04 0xab 0x03>;
		#size-cells = <0x02>;
		max-link-speed = <0x02>;
		device_type = "pci";
		interrupt-map-mask = <0x00 0x00 0x00 0x07>;
		reset-gpios = <0xae 0x05 0x00>;
		num-lanes = <0x01>;
		compatible = "rockchip,rk3568-pcie\0snps,dw-pcie";
		ranges = <0x800 0x00 0xf4000000 0x00 0xf4000000 0x00 0x100000 0x81000000 0x00 0xf4100000 0x00 0xf4100000 0x00 0x100000 0x82000000 0x00 0xf4200000 0x00 0xf4200000 0x00 0x1e00000 0xc3000000 0x03 0x00 0x03 0x00 0x00 0x40000000>;
		msi-map = <0x00 0xac 0x00 0x1000>;
		#interrupt-cells = <0x01>;
		status = "okay";
		interrupt-names = "sys\0pmc\0msg\0legacy\0err";
		phys = <0x24 0x02>;
		num-viewport = <0x08>;
		reg = <0x03 0xc0000000 0x00 0x400000 0x00 0xfe260000 0x00 0x10000>;
		linux,pci-domain = <0x00>;
		reset-names = "pipe";
		num-ib-windows = <0x06>;

		legacy-interrupt-controller {
			#address-cells = <0x00>;
			interrupts = <0x00 0x48 0x01>;
			interrupt-parent = <0x01>;
			#interrupt-cells = <0x01>;
			phandle = <0xab>;
			interrupt-controller;
		};
	};

	i2c@fdd40000 {
		pinctrl-names = "default";
		#address-cells = <0x01>;
		pinctrl-0 = <0x36>;
		clock-names = "i2c\0pclk";
		i2c-scl-rising-time-ns = <0xa0>;
		i2c-scl-falling-time-ns = <0x1e>;
		interrupts = <0x00 0x2e 0x04>;
		clocks = <0x33 0x07 0x33 0x2d>;
		#size-cells = <0x00>;
		clock-frequency = <0x61a80>;
		compatible = "rockchip,rk3399-i2c";
		status = "okay";
		reg = <0x00 0xfdd40000 0x00 0x1000>;

		pmic@20 {
			pinctrl-names = "default\0pmic-sleep\0pmic-power-off\0pmic-reset";
			pinctrl-2 = <0x3c 0x3d>;
			rockchip,system-power-controller;
			clock-output-names = "rk808-clkout1\0rk808-clkout2";
			pinctrl-0 = <0x39>;
			wakeup-source;
			interrupts = <0x03 0x08>;
			#clock-cells = <0x01>;
			interrupt-parent = <0x38>;
			vcc1-supply = <0x37>;
			pmic-reset-func = <0x00>;
			pinctrl-3 = <0x3c 0x3e>;
			vcc2-supply = <0x37>;
			compatible = "rockchip,rk809";
			vcc3-supply = <0x37>;
			pinctrl-1 = <0x3a 0x3b>;
			vcc4-supply = <0x37>;
			not-save-power-en = <0x01>;
			vcc5-supply = <0x37>;
			reg = <0x20>;
			phandle = <0x12b>;
			vcc6-supply = <0x37>;
			vcc7-supply = <0x37>;
			vcc8-supply = <0x37>;
			vcc9-supply = <0x37>;

			pinctrl_rk8xx {
				gpio-controller;
				#gpio-cells = <0x02>;

				rk817_slppin_pwrdn {
					function = "pin_fun2";
					pins = "gpio_slp";
					phandle = <0x3d>;
				};

				rk817_slppin_rst {
					function = "pin_fun3";
					pins = "gpio_slp";
					phandle = <0x3e>;
				};

				rk817_slppin_null {
					function = "pin_fun0";
					pins = "gpio_slp";
				};

				rk817_slppin_slp {
					function = "pin_fun1";
					pins = "gpio_slp";
					phandle = <0x3b>;
				};
			};

			pwrkey {
				status = "okay";
			};

			regulators {

				DCDC_REG4 {
					regulator-max-microvolt = <0x149970>;
					regulator-boot-on;
					regulator-init-microvolt = <0xdbba0>;
					regulator-always-on;
					regulator-min-microvolt = <0x7a120>;
					regulator-name = "vdd_npu";
					regulator-ramp-delay = <0x1771>;
					regulator-initial-mode = <0x02>;
					phandle = <0x63>;

					regulator-state-mem {
						regulator-off-in-suspend;
					};
				};

				LDO_REG4 {
					regulator-max-microvolt = <0x325aa0>;
					regulator-boot-on;
					regulator-always-on;
					regulator-min-microvolt = <0x325aa0>;
					regulator-name = "vccio_acodec";
					phandle = <0x2c>;

					regulator-state-mem {
						regulator-off-in-suspend;
					};
				};

				DCDC_REG2 {
					regulator-max-microvolt = <0x149970>;
					regulator-boot-on;
					regulator-init-microvolt = <0xdbba0>;
					regulator-always-on;
					regulator-min-microvolt = <0x7a120>;
					regulator-name = "vdd_gpu";
					regulator-ramp-delay = <0x1771>;
					regulator-initial-mode = <0x02>;
					phandle = <0x69>;

					regulator-state-mem {
						regulator-off-in-suspend;
					};
				};

				LDO_REG2 {
					regulator-max-microvolt = <0xdbba0>;
					regulator-boot-on;
					regulator-always-on;
					regulator-min-microvolt = <0xdbba0>;
					regulator-name = "vdda_0v9";

					regulator-state-mem {
						regulator-off-in-suspend;
					};
				};

				LDO_REG9 {
					regulator-max-microvolt = <0x1b7740>;
					regulator-boot-on;
					regulator-always-on;
					regulator-min-microvolt = <0x1b7740>;
					regulator-name = "vcca1v8_image";

					regulator-state-mem {
						regulator-off-in-suspend;
					};
				};

				SWITCH_REG1 {
					regulator-boot-on;
					regulator-always-on;
					regulator-name = "vcc_3v3";
					phandle = <0x2f>;

					regulator-state-mem {
						regulator-off-in-suspend;
					};
				};

				LDO_REG7 {
					regulator-max-microvolt = <0x1b7740>;
					regulator-boot-on;
					regulator-always-on;
					regulator-min-microvolt = <0x1b7740>;
					regulator-name = "vcca_1v8";
					phandle = <0x10a>;

					regulator-state-mem {
						regulator-off-in-suspend;
					};
				};

				DCDC_REG5 {
					regulator-max-microvolt = <0x1b7740>;
					regulator-boot-on;
					regulator-always-on;
					regulator-min-microvolt = <0x1b7740>;
					regulator-name = "vcc_1v8";
					phandle = <0x2e>;

					regulator-state-mem {
						regulator-off-in-suspend;
					};
				};

				LDO_REG5 {
					regulator-max-microvolt = <0x325aa0>;
					regulator-boot-on;
					regulator-always-on;
					regulator-min-microvolt = <0x1b7740>;
					regulator-name = "vccio_sd";
					phandle = <0x2d>;

					regulator-state-mem {
						regulator-off-in-suspend;
					};
				};

				DCDC_REG3 {
					regulator-boot-on;
					regulator-always-on;
					regulator-name = "vcc_ddr";
					regulator-initial-mode = <0x02>;

					regulator-state-mem {
						regulator-on-in-suspend;
					};
				};

				LDO_REG3 {
					regulator-max-microvolt = <0xdbba0>;
					regulator-boot-on;
					regulator-always-on;
					regulator-min-microvolt = <0xdbba0>;
					regulator-name = "vdda0v9_pmu";

					regulator-state-mem {
						regulator-suspend-microvolt = <0xdbba0>;
						regulator-on-in-suspend;
					};
				};

				DCDC_REG1 {
					regulator-max-microvolt = <0x149970>;
					regulator-boot-on;
					regulator-init-microvolt = <0xdbba0>;
					regulator-always-on;
					regulator-min-microvolt = <0x7a120>;
					regulator-name = "vdd_logic";
					regulator-ramp-delay = <0x1771>;
					regulator-initial-mode = <0x02>;
					phandle = <0x67>;

					regulator-state-mem {
						regulator-off-in-suspend;
					};
				};

				LDO_REG1 {
					regulator-max-microvolt = <0xdbba0>;
					regulator-boot-on;
					regulator-always-on;
					regulator-min-microvolt = <0xdbba0>;
					regulator-name = "vdda0v9_image";

					regulator-state-mem {
						regulator-off-in-suspend;
					};
				};

				SWITCH_REG2 {
					regulator-boot-on;
					regulator-always-on;
					regulator-name = "vcc3v3_sd";
					phandle = <0xbc>;

					regulator-state-mem {
						regulator-off-in-suspend;
					};
				};

				LDO_REG8 {
					regulator-max-microvolt = <0x1b7740>;
					regulator-boot-on;
					regulator-always-on;
					regulator-min-microvolt = <0x1b7740>;
					regulator-name = "vcca1v8_pmu";

					regulator-state-mem {
						regulator-suspend-microvolt = <0x1b7740>;
						regulator-on-in-suspend;
					};
				};

				LDO_REG6 {
					regulator-max-microvolt = <0x325aa0>;
					regulator-boot-on;
					regulator-always-on;
					regulator-min-microvolt = <0x325aa0>;
					regulator-name = "vcc3v3_pmu";
					phandle = <0x2b>;

					regulator-state-mem {
						regulator-suspend-microvolt = <0x325aa0>;
						regulator-on-in-suspend;
					};
				};
			};

			codec {
				pinctrl-names = "default";
				spk-volume = <0x03>;
				pinctrl-0 = <0x3f>;
				clock-names = "mclk";
				assigned-clocks = <0x20 0x1a3 0x20 0x1a6>;
				assigned-clock-parents = <0x20 0x48 0x20 0x48>;
				mic-in-differential;
				assigned-clock-rates = <0xbb8000>;
				clocks = <0x20 0x1a3>;
				#sound-dai-cells = <0x01>;
				hp-volume = <0x14>;
				compatible = "rockchip,rk809-codec\0rockchip,rk817-codec";
				status = "okay";
				phandle = <0x123>;
			};
		};

		tcs4525@1c {
			regulator-max-microvolt = <0x1535b0>;
			regulator-boot-on;
			regulator-init-microvolt = <0xdbba0>;
			regulator-always-on;
			regulator-min-microvolt = <0xadf34>;
			regulator-name = "vdd_cpu";
			regulator-ramp-delay = <0x8fc>;
			fcs,suspend-voltage-selector = <0x01>;
			compatible = "tcs,tcs452x";
			reg = <0x1c>;
			phandle = <0x05>;
			vin-supply = <0x37>;
			regulator-compatible = "fan53555-reg";

			regulator-state-mem {
				regulator-off-in-suspend;
			};
		};
	};

	pwm@fdd70030 {
		pinctrl-names = "active";
		pinctrl-0 = <0x45>;
		clock-names = "pwm\0pclk";
		interrupts = <0x00 0x52 0x04 0x00 0x56 0x04>;
		clocks = <0x33 0x0d 0x33 0x30>;
		#pwm-cells = <0x03>;
		compatible = "rockchip,rk3568-pwm\0rockchip,rk3328-pwm";
		status = "disabled";
		reg = <0x00 0xfdd70030 0x00 0x10>;
	};

	serial@fdd50000 {
		reg-io-width = <0x04>;
		pinctrl-names = "default";
		pinctrl-0 = <0x41>;
		clock-names = "baudclk\0apb_pclk";
		interrupts = <0x00 0x74 0x04>;
		clocks = <0x33 0x0b 0x33 0x2c>;
		compatible = "rockchip,rk3568-uart\0snps,dw-apb-uart";
		status = "disabled";
		reg = <0x00 0xfdd50000 0x00 0x100>;
		dmas = <0x40 0x00 0x40 0x01>;
		reg-shift = <0x02>;
	};

	otp@fe38c000 {
		#address-cells = <0x01>;
		clock-names = "usr\0sbpi\0apb\0phy";
		resets = <0x20 0x1cf>;
		clocks = <0x20 0x73 0x20 0x72 0x20 0x71 0x20 0x181>;
		#size-cells = <0x01>;
		compatible = "rockchip,rk3568-otp";
		reg = <0x00 0xfe38c000 0x00 0x4000>;
		reset-names = "otp_phy";

		cpu-leakage@1a {
			reg = <0x1a 0x01>;
			phandle = <0x06>;
		};

		core-pvtm@2a {
			reg = <0x2a 0x02>;
			phandle = <0x07>;
		};

		npu-tsadc-trim-h@31 {
			bits = <0x00 0x04>;
			reg = <0x31 0x01>;
			phandle = <0x109>;
		};

		npu-opp-info@42 {
			reg = <0x42 0x06>;
			phandle = <0x65>;
		};

		cpu-opp-info@36 {
			reg = <0x36 0x06>;
			phandle = <0x09>;
		};

		id@a {
			reg = <0x0a 0x10>;
			phandle = <0x0e>;
		};

		mbist-vmin@9 {
			bits = <0x00 0x04>;
			reg = <0x09 0x01>;
			phandle = <0x08>;
		};

		npu-tsadc-trim-l@30 {
			reg = <0x30 0x01>;
			phandle = <0x108>;
		};

		npu-leakage@1c {
			reg = <0x1c 0x01>;
			phandle = <0x64>;
		};

		cpu-code@2 {
			reg = <0x02 0x02>;
			phandle = <0x10>;
		};

		gpu-opp-info@3c {
			reg = <0x3c 0x06>;
			phandle = <0x6b>;
		};

		dmc-opp-info@48 {
			reg = <0x48 0x06>;
			phandle = <0xaa>;
		};

		tsadc-trim-base@32 {
			reg = <0x32 0x01>;
			phandle = <0x102>;
		};

		cpu-tsadc-trim-h@2f {
			bits = <0x00 0x04>;
			reg = <0x2f 0x01>;
			phandle = <0x107>;
		};

		cpu-version@8 {
			bits = <0x03 0x03>;
			reg = <0x08 0x01>;
			phandle = <0x0f>;
		};

		tsadc-trim-base-frac@31 {
			bits = <0x04 0x04>;
			reg = <0x31 0x01>;
			phandle = <0x103>;
		};

		gpu-leakage@1d {
			reg = <0x1d 0x01>;
			phandle = <0x6a>;
		};

		cpu-tsadc-trim-l@2e {
			reg = <0x2e 0x01>;
			phandle = <0x106>;
		};

		log-leakage@1b {
			reg = <0x1b 0x01>;
			phandle = <0x77>;
		};
	};

	pwm@fe700020 {
		pinctrl-names = "active";
		pinctrl-0 = <0x100>;
		clock-names = "pwm\0pclk";
		clocks = <0x20 0x160 0x20 0x15f>;
		#pwm-cells = <0x03>;
		compatible = "rockchip,rk3568-pwm\0rockchip,rk3328-pwm";
		status = "disabled";
		reg = <0x00 0xfe700020 0x00 0x10>;
	};

	pcie30-avdd0v9 {
		regulator-max-microvolt = <0xdbba0>;
		regulator-boot-on;
		regulator-always-on;
		regulator-min-microvolt = <0xdbba0>;
		regulator-name = "pcie30_avdd0v9";
		compatible = "regulator-fixed";
		vin-supply = <0x37>;
	};

	chosen {
		bootargs = "earlycon=uart8250,mmio32,0xfe660000 console=ttyFIQ0 root=PARTUUID=5452574f-02 rw rootwait";
	};

	iommu@fde4b000 {
		power-domains = <0x22 0x06>;
		clock-names = "aclk\0iface";
		interrupts = <0x00 0x97 0x04>;
		clocks = <0x20 0x28 0x20 0x29>;
		#iommu-cells = <0x00>;
		compatible = "rockchip,iommu-v2";
		status = "disabled";
		interrupt-names = "rknpu_mmu";
		reg = <0x00 0xfde4b000 0x00 0x40>;
		phandle = <0x62>;
	};

	rkcif@fdfe0000 {
		power-domains = <0x22 0x08>;
		iommus = <0x78>;
		clock-names = "aclk_cif\0hclk_cif\0dclk_cif\0iclk_cif_g";
		reg-names = "cif_regs";
		assigned-clocks = <0x20 0xd0>;
		assigned-clock-rates = <0x11e1a300>;
		resets = <0x20 0xf7 0x20 0xf8 0x20 0xf9 0x20 0xfb 0x20 0xfa>;
		interrupts = <0x00 0x92 0x04>;
		clocks = <0x20 0xce 0x20 0xcf 0x20 0xd0 0x20 0xd1>;
		compatible = "rockchip,rk3568-cif";
		status = "disabled";
		rockchip,grf = <0x34>;
		interrupt-names = "cif-intr";
		reg = <0x00 0xfdfe0000 0x00 0x8000>;
		phandle = <0x79>;
		reset-names = "rst_cif_a\0rst_cif_h\0rst_cif_d\0rst_cif_p\0rst_cif_i";
	};

	spi@fe610000 {
		pinctrl-names = "default\0high_speed";
		#address-cells = <0x01>;
		num-cs = <0x02>;
		pinctrl-0 = <0xdd 0xde 0xdf>;
		clock-names = "spiclk\0apb_pclk";
		interrupts = <0x00 0x67 0x04>;
		clocks = <0x20 0x152 0x20 0x151>;
		#size-cells = <0x00>;
		dma-names = "tx\0rx";
		compatible = "rockchip,rk3066-spi";
		pinctrl-1 = <0xdd 0xde 0xe0>;
		status = "disabled";
		reg = <0x00 0xfe610000 0x00 0x1000>;
		dmas = <0x40 0x14 0x40 0x15>;
	};

	pwm@fdd70020 {
		pinctrl-names = "active";
		pinctrl-0 = <0x44>;
		clock-names = "pwm\0pclk";
		clocks = <0x33 0x0d 0x33 0x30>;
		#pwm-cells = <0x03>;
		compatible = "rockchip,rk3568-pwm\0rockchip,rk3328-pwm";
		status = "disabled";
		reg = <0x00 0xfdd70020 0x00 0x10>;
	};

	rkvenc-opp-table {
		rockchip,pvtm-ch = <0x00 0x05>;
		nvmem-cells = <0x07>;
		compatible = "operating-points-v2";
		nvmem-cell-names = "pvtm";
		rockchip,pvtm-voltage-sel = <0x00 0x14820 0x00 0x14821 0x16378 0x01 0x16379 0x186a0 0x02>;
		phandle = <0x73>;

		opp-400000000 {
			opp-microvolt = <0xe7ef0>;
			opp-microvolt-L2 = <0xdbba0>;
			opp-hz = <0x00 0x17d78400>;
			opp-microvolt-L0 = <0xe7ef0>;
			opp-microvolt-L1 = <0xe1d48>;
		};

		opp-297000000 {
			opp-microvolt = <0xdbba0>;
			opp-microvolt-L2 = <0xd59f8>;
			opp-hz = <0x00 0x11b3dc40>;
			opp-microvolt-L0 = <0xdbba0>;
			opp-microvolt-L1 = <0xd59f8>;
		};
	};

	syscon@fdcb8000 {
		compatible = "rockchip,pcie30-phy-grf\0syscon";
		reg = <0x00 0xfdcb8000 0x00 0x10000>;
		phandle = <0x113>;
	};

	dwmmc@fe2c0000 {
		fifo-depth = <0x100>;
		clock-names = "biu\0ciu\0ciu-drive\0ciu-sample";
		resets = <0x20 0xd6>;
		interrupts = <0x00 0x63 0x04>;
		clocks = <0x20 0xb2 0x20 0xb3 0x20 0x18c 0x20 0x18d>;
		compatible = "rockchip,rk3568-dw-mshc\0rockchip,rk3288-dw-mshc";
		status = "disabled";
		reg = <0x00 0xfe2c0000 0x00 0x4000>;
		max-frequency = <0x8f0d180>;
		reset-names = "reset";
	};

	pwm@fe700010 {
		pinctrl-names = "active";
		pinctrl-0 = <0xff>;
		clock-names = "pwm\0pclk";
		clocks = <0x20 0x160 0x20 0x15f>;
		#pwm-cells = <0x03>;
		compatible = "rockchip,rk3568-pwm\0rockchip,rk3328-pwm";
		status = "disabled";
		reg = <0x00 0xfe700010 0x00 0x10>;
	};

	i2c@fe5b0000 {
		pinctrl-names = "default";
		#address-cells = <0x01>;
		pinctrl-0 = <0xd9>;
		clock-names = "i2c\0pclk";
		interrupts = <0x00 0x30 0x04>;
		clocks = <0x20 0x14a 0x20 0x149>;
		#size-cells = <0x00>;
		compatible = "rockchip,rk3399-i2c";
		status = "disabled";
		reg = <0x00 0xfe5b0000 0x00 0x1000>;
	};

	qos@fe190300 {
		compatible = "syscon";
		reg = <0x00 0xfe190300 0x00 0x20>;
		phandle = <0x5e>;
	};

	pwm@fdd70010 {
		pinctrl-names = "active";
		pinctrl-0 = <0x43>;
		clock-names = "pwm\0pclk";
		clocks = <0x33 0x0d 0x33 0x30>;
		#pwm-cells = <0x03>;
		compatible = "rockchip,rk3568-pwm\0rockchip,rk3328-pwm";
		status = "disabled";
		reg = <0x00 0xfdd70010 0x00 0x10>;
	};

	csi2-dphy2 {
		rockchip,hw = <0x10f>;
		compatible = "rockchip,rk3568-csi2-dphy";
		status = "disabled";
	};

	pwm@fe700000 {
		pinctrl-names = "active";
		pinctrl-0 = <0xfe>;
		clock-names = "pwm\0pclk";
		clocks = <0x20 0x160 0x20 0x15f>;
		#pwm-cells = <0x03>;
		compatible = "rockchip,rk3568-pwm\0rockchip,rk3328-pwm";
		status = "disabled";
		reg = <0x00 0xfe700000 0x00 0x10>;
	};

	syscon@fdc50000 {
		compatible = "rockchip,rk3568-pipegrf\0syscon";
		reg = <0x00 0xfdc50000 0x00 0x1000>;
		phandle = <0x10b>;
	};

	fiq-debugger {
		pinctrl-names = "default";
		rockchip,irq-mode-enable = <0x01>;
		rockchip,baudrate = <0x1c200>;
		pinctrl-0 = <0xee>;
		interrupts = <0x00 0xfc 0x08>;
		rockchip,wake-irq = <0x00>;
		compatible = "rockchip,fiq-debugger";
		status = "okay";
		rockchip,serial-id = <0x02>;
	};

	rkisp-vir0 {
		rockchip,hw = <0x7d>;
		compatible = "rockchip,rkisp-vir";
		status = "disabled";
	};

	dsi@fe070000 {
		power-domains = <0x22 0x09>;
		#address-cells = <0x01>;
		phy-names = "dphy";
		clock-names = "pclk\0hclk";
		resets = <0x20 0x111>;
		interrupts = <0x00 0x45 0x04>;
		clocks = <0x20 0xe9 0x20 0xda>;
		#size-cells = <0x00>;
		compatible = "rockchip,rk3568-mipi-dsi";
		status = "disabled";
		rockchip,grf = <0x34>;
		phys = <0x96>;
		reg = <0x00 0xfe070000 0x00 0x10000>;
		reset-names = "apb";

		ports {
			#address-cells = <0x01>;
			#size-cells = <0x00>;

			port@0 {
				#address-cells = <0x01>;
				#size-cells = <0x00>;
				reg = <0x00>;

				endpoint@1 {
					remote-endpoint = <0x97>;
					status = "disabled";
					reg = <0x01>;
					phandle = <0x8f>;
				};

				endpoint@0 {
					remote-endpoint = <0x16>;
					status = "disabled";
					reg = <0x00>;
					phandle = <0x8b>;
				};
			};
		};
	};

	clock-controller@fdd20000 {
		#reset-cells = <0x01>;
		assigned-clocks = <0x33 0x05 0x20 0x106 0x20 0x10b 0x33 0x01 0x33 0x2b 0x20 0x03 0x20 0x19b 0x20 0x09 0x20 0x19c 0x20 0x19d 0x20 0x1a1 0x20 0x19e 0x20 0x19f 0x20 0x1a0 0x20 0x04 0x20 0x10d 0x20 0x10e 0x20 0x173 0x20 0x174 0x20 0x175 0x20 0x176 0x20 0xc9 0x20 0xca 0x20 0x06 0x20 0x7e 0x20 0x7f 0x20 0x3d 0x20 0x41 0x20 0x45 0x20 0x49 0x20 0x4d 0x20 0x4d 0x20 0x55 0x20 0x51 0x20 0x5d 0x20 0xdd>;
		assigned-clock-parents = <0x33 0x08 0x20 0x04 0x20 0x04>;
		assigned-clock-rates = <0x8000 0x11e1a300 0x11e1a300 0xbebc200 0x5f5e100 0x3b9aca00 0x1dcd6500 0x13d92d40 0xee6b280 0x7735940 0x5f5e100 0x3b9aca0 0x2faf080 0x17d7840 0x46cf7100 0x8f0d180 0x5f5e100 0x1dcd6500 0x17d78400 0x8f0d180 0x5f5e100 0x11e1a300 0x8f0d180 0x47868c00 0x17d78400 0x5f5e100 0x46cf7100 0x46cf7100 0x46cf7100 0x46cf7100 0x46cf7100 0x46cf7100 0x46cf7100 0x46cf7100 0x46cf7100 0x1dcd6500>;
		#clock-cells = <0x01>;
		compatible = "rockchip,rk3568-cru";
		rockchip,grf = <0x34>;
		reg = <0x00 0xfdd20000 0x00 0x1000>;
		phandle = <0x20>;
	};

	nocp-vdec@fe102800 {
		compatible = "rockchip,rk3568-nocp";
		reg = <0x00 0xfe102800 0x00 0x400>;
	};

	pwm@fdd70000 {
		pinctrl-names = "active";
		pinctrl-0 = <0x42>;
		clock-names = "pwm\0pclk";
		clocks = <0x33 0x0d 0x33 0x30>;
		#pwm-cells = <0x03>;
		compatible = "rockchip,rk3568-pwm\0rockchip,rk3328-pwm";
		status = "okay";
		reg = <0x00 0xfdd70000 0x00 0x10>;
	};

	dc-12v {
		regulator-max-microvolt = <0xb71b00>;
		regulator-boot-on;
		regulator-always-on;
		regulator-min-microvolt = <0xb71b00>;
		regulator-name = "dc_12v";
		compatible = "regulator-fixed";
		phandle = <0x126>;
	};

	iommu@fdea0800 {
		power-domains = <0x22 0x0b>;
		clock-names = "aclk\0iface";
		interrupts = <0x00 0x8a 0x04>;
		clocks = <0x20 0xee 0x20 0xef>;
		#iommu-cells = <0x00>;
		compatible = "rockchip,iommu-v2";
		status = "okay";
		interrupt-names = "vdpu_mmu";
		reg = <0x00 0xfdea0800 0x00 0x40>;
		phandle = <0x6c>;
	};

	syscon@fda00000 {
		compatible = "rockchip,rk3568-xpcs\0syscon";
		status = "disabled";
		reg = <0x00 0xfda00000 0x00 0x200000>;
	};

	syscon@fdc90000 {
		compatible = "rockchip,pipe-phy-grf\0syscon";
		reg = <0x00 0xfdc90000 0x00 0x1000>;
		phandle = <0x10e>;
	};

	bus-npu {
		clock-names = "bus";
		rockchip,busfreq-policy = "clkfreq";
		clocks = <0x02 0x02>;
		compatible = "rockchip,rk3568-bus";
		status = "disabled";
		bus-supply = <0x67>;
		operating-points-v2 = <0x66>;
		pvtm-supply = <0x05>;
	};

	i2s1-mclkin-tx {
		clock-output-names = "i2s1_mclkin_tx";
		#clock-cells = <0x00>;
		clock-frequency = <0xbb8000>;
		compatible = "fixed-clock";
	};

	dwmmc@fe000000 {
		fifo-depth = <0x100>;
		pinctrl-names = "default";
		supports-sdio;
		pinctrl-0 = <0x9f 0xa0 0xa1>;
		clock-names = "biu\0ciu\0ciu-drive\0ciu-sample";
		cap-sd-highspeed;
		bus-width = <0x04>;
		non-removable;
		resets = <0x20 0xeb>;
		cap-sdio-irq;
		interrupts = <0x00 0x64 0x04>;
		clocks = <0x20 0xc1 0x20 0xc2 0x20 0x18e 0x20 0x18f>;
		keep-power-in-suspend;
		compatible = "rockchip,rk3568-dw-mshc\0rockchip,rk3288-dw-mshc";
		status = "okay";
		disable-wp;
		mmc-pwrseq = <0x9e>;
		reg = <0x00 0xfe000000 0x00 0x4000>;
		sd-uhs-sdr104;
		max-frequency = <0x8f0d180>;
		reset-names = "reset";
	};

	i2s@fe420000 {
		pinctrl-names = "default";
		rockchip,cru = <0x20>;
		pinctrl-0 = <0xc6 0xc7 0xc8 0xc9>;
		clock-names = "mclk_tx\0mclk_rx\0hclk";
		interrupts = <0x00 0x36 0x04>;
		clocks = <0x20 0x4f 0x20 0x4f 0x20 0x3b>;
		dma-names = "tx\0rx";
		#sound-dai-cells = <0x00>;
		compatible = "rockchip,rk3568-i2s-tdm";
		status = "disabled";
		rockchip,grf = <0x34>;
		reg = <0x00 0xfe420000 0x00 0x1000>;
		dmas = <0xc1 0x04 0xc1 0x05>;
		rockchip,clk-trcm = <0x01>;
	};

	dmac@fe550000 {
		clock-names = "apb_pclk";
		interrupts = <0x00 0x10 0x04 0x00 0x0f 0x04>;
		clocks = <0x20 0x10d>;
		arm,pl330-periph-burst;
		compatible = "arm,pl330\0arm,primecell";
		reg = <0x00 0xfe550000 0x00 0x4000>;
		phandle = <0xc1>;
		#dma-cells = <0x01>;
	};

	qos@fe190280 {
		compatible = "syscon";
		reg = <0x00 0xfe190280 0x00 0x20>;
		phandle = <0x5d>;
	};

	iommu@fdee0800 {
		power-domains = <0x22 0x0a>;
		clock-names = "aclk\0iface";
		interrupts = <0x00 0x3f 0x04>;
		clocks = <0x20 0xfd 0x20 0xfe>;
		#iommu-cells = <0x00>;
		compatible = "rockchip,iommu-v2";
		status = "okay";
		interrupt-names = "vepu_mmu";
		reg = <0x00 0xfdee0800 0x00 0x40>;
		phandle = <0x70>;
	};

	cpus {
		#address-cells = <0x02>;
		#size-cells = <0x00>;

		cpu@300 {
			clocks = <0x02 0x00>;
			cpu-idle-states = <0x04>;
			device_type = "cpu";
			compatible = "arm,cortex-a55";
			reg = <0x00 0x300>;
			enable-method = "psci";
			phandle = <0x0d>;
			operating-points-v2 = <0x03>;
		};

		idle-states {
			entry-method = "psci";

			cpu-sleep {
				entry-latency-us = <0x64>;
				local-timer-stop;
				exit-latency-us = <0x78>;
				arm,psci-suspend-param = <0x10000>;
				compatible = "arm,idle-state";
				phandle = <0x04>;
				min-residency-us = <0x3e8>;
			};
		};

		cpu@200 {
			clocks = <0x02 0x00>;
			cpu-idle-states = <0x04>;
			device_type = "cpu";
			compatible = "arm,cortex-a55";
			reg = <0x00 0x200>;
			enable-method = "psci";
			phandle = <0x0c>;
			operating-points-v2 = <0x03>;
		};

		cpu@0 {
			cpu-supply = <0x05>;
			clocks = <0x02 0x00>;
			cpu-idle-states = <0x04>;
			device_type = "cpu";
			compatible = "arm,cortex-a55";
			dynamic-power-coefficient = <0xbb>;
			reg = <0x00 0x00>;
			enable-method = "psci";
			phandle = <0x0a>;
			operating-points-v2 = <0x03>;
			#cooling-cells = <0x02>;
		};

		cpu@100 {
			clocks = <0x02 0x00>;
			cpu-idle-states = <0x04>;
			device_type = "cpu";
			compatible = "arm,cortex-a55";
			reg = <0x00 0x100>;
			enable-method = "psci";
			phandle = <0x0b>;
			operating-points-v2 = <0x03>;
		};
	};

	spdif-out {
		#sound-dai-cells = <0x00>;
		compatible = "linux,spdif-dit";
		status = "disabled";
		phandle = <0x125>;
	};

	board {
		machine = "NANOPI5";
		nvmem-cells = <0x0e 0x0f>;
		model = "NanoPi 5 Series";
		hwrev = <0xff>;
		compatible = "friendlyelec,board";
		nvmem-cell-names = "id\0cpu-version";
	};

	vepu@fdee0000 {
		power-domains = <0x22 0x0a>;
		iommus = <0x70>;
		clock-names = "aclk_vcodec\0hclk_vcodec";
		resets = <0x20 0x12e 0x20 0x12f>;
		interrupts = <0x00 0x40 0x04>;
		clocks = <0x20 0xfd 0x20 0xfe>;
		rockchip,srv = <0x6d>;
		rockchip,taskqueue-node = <0x02>;
		rockchip,disable-auto-freq;
		compatible = "rockchip,vpu-encoder-v2";
		rockchip,resetgroup-node = <0x02>;
		status = "okay";
		reg = <0x00 0xfdee0000 0x00 0x400>;
		reset-names = "video_a\0video_h";
	};

	pwm@fe6f0030 {
		pinctrl-names = "active";
		pinctrl-0 = <0xfd>;
		clock-names = "pwm\0pclk";
		interrupts = <0x00 0x54 0x04 0x00 0x58 0x04>;
		clocks = <0x20 0x15d 0x20 0x15c>;
		#pwm-cells = <0x03>;
		compatible = "rockchip,rk3568-pwm\0rockchip,rk3328-pwm";
		status = "disabled";
		reg = <0x00 0xfe6f0030 0x00 0x10>;
	};

	nocp-vo@fe103000 {
		compatible = "rockchip,rk3568-nocp";
		reg = <0x00 0xfe103000 0x00 0x400>;
	};

	sata@fc000000 {
		power-domains = <0x22 0x0f>;
		phy-names = "sata-phy";
		clock-names = "sata\0pmalive\0rxoob";
		interrupts = <0x00 0x5e 0x04>;
		clocks = <0x20 0x96 0x20 0x97 0x20 0x98>;
		compatible = "snps,dwc-ahci";
		status = "okay";
		interrupt-names = "hostc";
		phys = <0x21 0x01>;
		reg = <0x00 0xfc000000 0x00 0x1000>;
		ports-implemented = <0x01>;
	};

	phy@fe820000 {
		rockchip,pipe-grf = <0x10b>;
		rockchip,dis-u3otg0-port;
		clock-names = "refclk\0apbclk\0pipe_clk";
		assigned-clocks = <0x33 0x1f>;
		assigned-clock-rates = <0x5f5e100>;
		resets = <0x20 0x1c4 0x20 0x1c5>;
		clocks = <0x33 0x1f 0x20 0x17c 0x20 0x7f>;
		#phy-cells = <0x01>;
		compatible = "rockchip,rk3568-naneng-combphy";
		status = "okay";
		rockchip,pipe-phy-grf = <0x10c>;
		reg = <0x00 0xfe820000 0x00 0x100>;
		phandle = <0x21>;
		reset-names = "combphy-apb\0combphy";
	};

	serial@fe6d0000 {
		reg-io-width = <0x04>;
		pinctrl-names = "default";
		pinctrl-0 = <0xf5>;
		clock-names = "baudclk\0apb_pclk";
		interrupts = <0x00 0x7d 0x04>;
		clocks = <0x20 0x13f 0x20 0x13c>;
		compatible = "rockchip,rk3568-uart\0snps,dw-apb-uart";
		status = "disabled";
		reg = <0x00 0xfe6d0000 0x00 0x100>;
		dmas = <0x40 0x12 0x40 0x13>;
		reg-shift = <0x02>;
	};

	reserved-memory {
		#address-cells = <0x02>;
		#size-cells = <0x02>;
		ranges;

		linux,cma {
			linux,cma-default;
			inactive;
			compatible = "shared-dma-pool";
			reg = <0x00 0x10000000 0x00 0x800000>;
			reusable;
		};

		drm-logo@00000000 {
			compatible = "rockchip,drm-logo";
			reg = <0x00 0x00 0x00 0x00>;
			phandle = <0x11>;
		};

		ramoops@110000 {
			record-size = <0x20000>;
			pmsg-size = <0x50000>;
			compatible = "ramoops";
			console-size = <0x80000>;
			reg = <0x00 0x110000 0x00 0xf0000>;
			ftrace-size = <0x00>;
		};

		drm-cubic-lut@00000000 {
			compatible = "rockchip,drm-cubic-lut";
			reg = <0x00 0x00 0x00 0x00>;
			phandle = <0x12>;
		};
	};

	iommu@fe043e00 {
		clock-names = "aclk\0iface";
		interrupts = <0x00 0x94 0x04>;
		clocks = <0x20 0xdd 0x20 0xde>;
		#iommu-cells = <0x00>;
		compatible = "rockchip,iommu-v2";
		status = "okay";
		interrupt-names = "vop_mmu";
		reg = <0x00 0xfe043e00 0x00 0x100 0x00 0xfe043f00 0x00 0x100>;
		phandle = <0x89>;
		rockchip,disable-device-link-resume;
	};

	qos@fe138180 {
		compatible = "syscon";
		reg = <0x00 0xfe138180 0x00 0x20>;
		phandle = <0x58>;
	};

	csi2-dphy-hw@fe870000 {
		clock-names = "pclk";
		clocks = <0x20 0x179>;
		compatible = "rockchip,rk3568-csi2-dphy-hw";
		status = "disabled";
		rockchip,grf = <0x34>;
		reg = <0x00 0xfe870000 0x00 0x1000>;
		phandle = <0x10f>;
	};

	csi2-dphy0 {
		rockchip,hw = <0x10f>;
		compatible = "rockchip,rk3568-csi2-dphy";
		status = "disabled";
	};

	rng@fe388000 {
		clock-names = "clk_trng\0hclk_trng";
		resets = <0x20 0x6d>;
		clocks = <0x20 0x70 0x20 0x6f>;
		compatible = "rockchip,cryptov2-rng";
		status = "okay";
		reg = <0x00 0xfe388000 0x00 0x2000>;
		reset-names = "reset";
	};

	external-gmac0-clock {
		clock-output-names = "gmac0_clkin";
		#clock-cells = <0x00>;
		clock-frequency = <0x7735940>;
		compatible = "fixed-clock";
	};

	i2s1-mclkin-rx {
		clock-output-names = "i2s1_mclkin_rx";
		#clock-cells = <0x00>;
		clock-frequency = <0xbb8000>;
		compatible = "fixed-clock";
	};

	pwm@fe6f0020 {
		pinctrl-names = "active";
		pinctrl-0 = <0xfc>;
		clock-names = "pwm\0pclk";
		clocks = <0x20 0x15d 0x20 0x15c>;
		#pwm-cells = <0x03>;
		compatible = "rockchip,rk3568-pwm\0rockchip,rk3328-pwm";
		status = "disabled";
		reg = <0x00 0xfe6f0020 0x00 0x10>;
	};

	pdm@fe440000 {
		pinctrl-names = "default";
		pinctrl-0 = <0xce 0xcf 0xd0 0xd1 0xd2 0xd3>;
		clock-names = "pdm_clk\0pdm_hclk";
		clocks = <0x20 0x5a 0x20 0x59>;
		dma-names = "rx";
		#sound-dai-cells = <0x00>;
		compatible = "rockchip,rk3568-pdm\0rockchip,pdm";
		status = "disabled";
		reg = <0x00 0xfe440000 0x00 0x1000>;
		phandle = <0x121>;
		dmas = <0xc1 0x09>;
	};

	phy@fe860000 {
		power-domains = <0x22 0x09>;
		clock-names = "ref\0pclk\0pclk_host";
		reg-names = "phy\0host";
		resets = <0x20 0x1bc>;
		clocks = <0x33 0x19 0x20 0x17b 0x20 0xe9>;
		#clock-cells = <0x00>;
		#phy-cells = <0x00>;
		compatible = "rockchip,rk3568-dsi-dphy\0rockchip,rk3568-video-phy";
		status = "disabled";
		reg = <0x00 0xfe860000 0x00 0x10000 0x00 0xfe070000 0x00 0x10000>;
		phandle = <0x96>;
		reset-names = "apb";
	};

	pwm@fe6f0010 {
		pinctrl-names = "active";
		pinctrl-0 = <0xfb>;
		clock-names = "pwm\0pclk";
		clocks = <0x20 0x15d 0x20 0x15c>;
		#pwm-cells = <0x03>;
		compatible = "rockchip,rk3568-pwm\0rockchip,rk3328-pwm";
		status = "disabled";
		reg = <0x00 0xfe6f0010 0x00 0x10>;
	};

	qos@fe158000 {
		compatible = "syscon";
		reg = <0x00 0xfe158000 0x00 0x20>;
		phandle = <0x4e>;
	};

	vop@fe040000 {
		power-domains = <0x22 0x09>;
		iommus = <0x89>;
		support-multi-area;
		clock-names = "aclk_vop\0hclk_vop\0dclk_vp0\0dclk_vp1\0dclk_vp2";
		reg-names = "regs\0gamma_lut";
		assigned-clocks = <0x20 0xdf 0x20 0xe0>;
		assigned-clock-parents = <0x33 0x02 0x20 0x05>;
		interrupts = <0x00 0x94 0x04>;
		clocks = <0x20 0xdd 0x20 0xde 0x20 0xdf 0x20 0xe0 0x20 0xe1>;
		compatible = "rockchip,rk3568-vop";
		status = "okay";
		rockchip,grf = <0x34>;
		reg = <0x00 0xfe040000 0x00 0x3000 0x00 0xfe044000 0x00 0x1000>;

		ports {
			#address-cells = <0x01>;
			#size-cells = <0x00>;
			phandle = <0x13>;

			port@0 {
				#address-cells = <0x01>;
				#size-cells = <0x00>;
				reg = <0x00>;

				endpoint@3 {
					remote-endpoint = <0x8d>;
					reg = <0x03>;
					phandle = <0x18>;
				};

				endpoint@1 {
					remote-endpoint = <0x8b>;
					reg = <0x01>;
					phandle = <0x16>;
				};

				endpoint@2 {
					remote-endpoint = <0x8c>;
					reg = <0x02>;
					phandle = <0x17>;
				};

				endpoint@0 {
					remote-endpoint = <0x8a>;
					reg = <0x00>;
					phandle = <0x15>;
				};
			};

			port@1 {
				#address-cells = <0x01>;
				#size-cells = <0x00>;
				reg = <0x01>;

				endpoint@3 {
					remote-endpoint = <0x91>;
					reg = <0x03>;
					phandle = <0x9b>;
				};

				endpoint@1 {
					remote-endpoint = <0x8f>;
					reg = <0x01>;
					phandle = <0x97>;
				};

				endpoint@4 {
					remote-endpoint = <0x92>;
					reg = <0x04>;
					phandle = <0x19>;
				};

				endpoint@2 {
					remote-endpoint = <0x90>;
					reg = <0x02>;
					phandle = <0x9d>;
				};

				endpoint@0 {
					remote-endpoint = <0x8e>;
					reg = <0x00>;
					phandle = <0x95>;
				};
			};

			port@2 {
				#address-cells = <0x01>;
				#size-cells = <0x00>;
				reg = <0x02>;

				endpoint@1 {
					remote-endpoint = <0x94>;
					reg = <0x01>;
					phandle = <0x1a>;
				};

				endpoint@0 {
					remote-endpoint = <0x93>;
					reg = <0x00>;
					phandle = <0x31>;
				};
			};
		};
	};

	xpcs-gmac0-clock {
		clock-output-names = "clk_gmac0_xpcs_mii";
		#clock-cells = <0x00>;
		clock-frequency = <0x7735940>;
		compatible = "fixed-clock";
	};

	serial@fe660000 {
		reg-io-width = <0x04>;
		pinctrl-names = "default";
		pinctrl-0 = <0xee>;
		clock-names = "baudclk\0apb_pclk";
		interrupts = <0x00 0x76 0x04>;
		clocks = <0x20 0x123 0x20 0x120>;
		compatible = "rockchip,rk3568-uart\0snps,dw-apb-uart";
		status = "disabled";
		reg = <0x00 0xfe660000 0x00 0x100>;
		dmas = <0x40 0x04 0x40 0x05>;
		reg-shift = <0x02>;
	};

	dmc-opp-table {
		rockchip,pvtm-ch = <0x00 0x05>;
		nvmem-cells = <0x77 0x07 0x08 0xaa>;
		rockchip,low-temp = <0x00>;
		rockchip,max-volt = <0xf4240>;
		rockchip,leakage-voltage-sel = <0x01 0x50 0x00 0x51 0xfe 0x01>;
		rockchip,low-temp-adjust-volt = <0x00 0x618 0x124f8>;
		compatible = "operating-points-v2";
		nvmem-cell-names = "leakage\0pvtm\0mbist-vmin\0opp-info";
		rockchip,pvtm-voltage-sel = <0x00 0x14820 0x00 0x14821 0x186a0 0x01>;
		phandle = <0xa4>;
		rockchip,temp-hysteresis = <0x1388>;
		mbist-vmin = <0xc96a8 0xdbba0 0xe7ef0>;

		opp-1560000000 {
			opp-microvolt = <0xdbba0 0xdbba0 0xf4240>;
			opp-hz = <0x00 0x5cfbb600>;
			opp-microvolt-L0 = <0xdbba0 0xdbba0 0xf4240>;
			opp-microvolt-L1 = <0xd59f8 0xd59f8 0xf4240>;
		};
	};

	rkcif_dvp {
		rockchip,hw = <0x79>;
		compatible = "rockchip,rkcif-dvp";
		status = "disabled";
		phandle = <0x7a>;
	};

	rkcif_mipi_lvds {
		rockchip,hw = <0x79>;
		compatible = "rockchip,rkcif-mipi-lvds";
		status = "disabled";
		phandle = <0x7b>;
	};

	eink@fdf00000 {
		clock-names = "pclk\0hclk";
		interrupts = <0x00 0xb2 0x04>;
		clocks = <0x20 0xff 0x20 0x100>;
		compatible = "rockchip,rk3568-eink-tcon";
		status = "disabled";
		reg = <0x00 0xfdf00000 0x00 0x74>;
	};

	pwm@fe6f0000 {
		pinctrl-names = "active";
		pinctrl-0 = <0xfa>;
		clock-names = "pwm\0pclk";
		clocks = <0x20 0x15d 0x20 0x15c>;
		#pwm-cells = <0x03>;
		compatible = "rockchip,rk3568-pwm\0rockchip,rk3328-pwm";
		status = "disabled";
		reg = <0x00 0xfe6f0000 0x00 0x10>;
	};

	memory {
		device_type = "memory";
		reg = <0x00 0x200000 0x00 0xefe00000 0x01 0xf0000000 0x00 0x10000000 0x00 0x00 0x00 0x00 0x00 0x00 0x00 0x00 0x00 0x00 0x00 0x00 0x00 0x00 0x00 0x00 0x00 0x00 0x00 0x00 0x00 0x00 0x00 0x00 0x00 0x00 0x00 0x00 0x00 0x00 0x00 0x00 0x00 0x00 0x00 0x00 0x00 0x00 0x00 0x00>;
	};

	qos@fe198000 {
		compatible = "syscon";
		reg = <0x00 0xfe198000 0x00 0x20>;
		phandle = <0x55>;
	};

	spi@fe300000 {
		#address-cells = <0x01>;
		clock-names = "clk_sfc\0hclk_sfc";
		assigned-clocks = <0x20 0x78>;
		assigned-clock-rates = <0x5f5e100>;
		interrupts = <0x00 0x65 0x04>;
		clocks = <0x20 0x78 0x20 0x76>;
		#size-cells = <0x00>;
		compatible = "rockchip,sfc";
		status = "disabled";
		reg = <0x00 0xfe300000 0x00 0x4000>;
	};

	cpu0-opp-table {
		rockchip,pvtm-sample-time = <0x3e8>;
		rockchip,pvtm-ch = <0x00 0x05>;
		nvmem-cells = <0x06 0x07 0x08 0x09>;
		rockchip,pvtm-number = <0x0a>;
		rockchip,low-temp = <0x00>;
		opp-shared;
		rockchip,max-volt = <0x118c30>;
		rockchip,pvtm-freq = <0x639c0>;
		rockchip,pvtm-ref-temp = <0x28>;
		rockchip,thermal-zone = "soc-thermal";
		rockchip,low-temp-adjust-volt = <0x00 0x7c8 0x124f8>;
		compatible = "operating-points-v2";
		nvmem-cell-names = "leakage\0pvtm\0mbist-vmin\0opp-info";
		rockchip,pvtm-voltage-sel = <0x00 0x14820 0x00 0x14821 0x153d8 0x01 0x153d9 0x16378 0x02 0x16379 0x186a0 0x03>;
		phandle = <0x03>;
		rockchip,pvtm-temp-prop = <0x1a 0x1a>;
		rockchip,temp-hysteresis = <0x1388>;
		rockchip,pvtm-error = <0x3e8>;
		mbist-vmin = <0xc96a8 0xdbba0 0xe7ef0>;
		rockchip,pvtm-volt = <0xdbba0>;

		opp-1992000000 {
			opp-microvolt = <0x118c30 0x118c30 0x118c30>;
			opp-microvolt-L2 = <0x112a88 0x112a88 0x118c30>;
			opp-hz = <0x00 0x76bb8200>;
			opp-microvolt-L0 = <0x118c30 0x118c30 0x118c30>;
			opp-microvolt-L3 = <0x10c8e0 0x10c8e0 0x118c30>;
			clock-latency-ns = <0x9c40>;
			opp-microvolt-L1 = <0x118c30 0x118c30 0x118c30>;
		};

		opp-1800000000 {
			opp-microvolt = <0x118c30 0x118c30 0x118c30>;
			opp-microvolt-L2 = <0x106738 0x106738 0x118c30>;
			opp-hz = <0x00 0x6b49d200>;
			opp-microvolt-L0 = <0x118c30 0x118c30 0x118c30>;
			opp-microvolt-L3 = <0x100590 0x100590 0x118c30>;
			clock-latency-ns = <0x9c40>;
			opp-microvolt-L1 = <0x10c8e0 0x10c8e0 0x118c30>;
		};

		opp-1608000000 {
			opp-microvolt = <0x10c8e0 0x10c8e0 0x118c30>;
			opp-microvolt-L2 = <0xfa3e8 0xfa3e8 0x118c30>;
			opp-hz = <0x00 0x5fd82200>;
			opp-microvolt-L0 = <0x10c8e0 0x10c8e0 0x118c30>;
			opp-microvolt-L3 = <0xf4240 0xf4240 0x118c30>;
			clock-latency-ns = <0x9c40>;
			opp-microvolt-L1 = <0x100590 0x100590 0x118c30>;
		};

		opp-1104000000 {
			opp-microvolt = <0xdbba0 0xdbba0 0x118c30>;
			opp-microvolt-L2 = <0xcf850 0xcf850 0x118c30>;
			opp-hz = <0x00 0x41cdb400>;
			opp-microvolt-L0 = <0xdbba0 0xdbba0 0x118c30>;
			opp-microvolt-L3 = <0xcf850 0xcf850 0x118c30>;
			clock-latency-ns = <0x9c40>;
			opp-microvolt-L1 = <0xcf850 0xcf850 0x118c30>;
		};

		opp-816000000 {
			opp-microvolt = <0xcf850 0xcf850 0x118c30>;
			opp-hz = <0x00 0x30a32c00>;
			opp-suspend;
			clock-latency-ns = <0x9c40>;
		};

		opp-600000000 {
			opp-microvolt = <0xcf850 0xcf850 0x118c30>;
			opp-hz = <0x00 0x23c34600>;
			clock-latency-ns = <0x9c40>;
		};

		opp-1416000000 {
			opp-microvolt = <0xfa3e8 0xfa3e8 0x118c30>;
			opp-microvolt-L2 = <0xe7ef0 0xe7ef0 0x118c30>;
			opp-hz = <0x00 0x54667200>;
			opp-microvolt-L0 = <0xfa3e8 0xfa3e8 0x118c30>;
			opp-microvolt-L3 = <0xe1d48 0xe1d48 0x118c30>;
			clock-latency-ns = <0x9c40>;
			opp-microvolt-L1 = <0xee098 0xee098 0x118c30>;
		};

		opp-408000000 {
			opp-microvolt = <0xcf850 0xcf850 0x118c30>;
			opp-hz = <0x00 0x18519600>;
			clock-latency-ns = <0x9c40>;
		};
	};

	i2s2-mclkin {
		clock-output-names = "i2s2_mclkin";
		#clock-cells = <0x00>;
		clock-frequency = <0xbb8000>;
		compatible = "fixed-clock";
	};

	pvtm@fde90000 {
		#address-cells = <0x01>;
		#size-cells = <0x00>;
		compatible = "rockchip,rk3568-npu-pvtm";
		reg = <0x00 0xfde90000 0x00 0x100>;

		pvtm@2 {
			clock-names = "clk\0pclk\0hclk";
			thermal-zone = "soc-thermal";
			resets = <0x20 0x2e 0x20 0x2d>;
			clocks = <0x20 0x2b 0x20 0x2a 0x20 0x25>;
			reg = <0x02>;
			reset-names = "rts\0rst-p";
		};
	};

	wireless-wlan {
		pinctrl-names = "default";
		pinctrl-0 = <0x12d>;
		WIFI,host_wake_irq = <0xae 0x1c 0x00>;
		wifi_chip_type = "ap6255";
		compatible = "wlan-platdata";
		status = "okay";
		rockchip,grf = <0x34>;
		WIFI,poweren_gpio = <0xae 0x1d 0x00>;
	};

	rockchip-system-monitor {
		rockchip,thermal-zone = "soc-thermal";
		compatible = "rockchip,system-monitor";
	};

	usbhost {
		#address-cells = <0x02>;
		clock-names = "ref_clk\0suspend_clk\0bus_clk\0pipe_clk";
		clocks = <0x20 0xa9 0x20 0xaa 0x20 0xa8 0x20 0x7f>;
		#size-cells = <0x02>;
		compatible = "rockchip,rk3568-dwc3\0rockchip,rk3399-dwc3";
		ranges;
		status = "okay";

		dwc3@fd000000 {
			power-domains = <0x22 0x0f>;
			snps,dis_enblslpm_quirk;
			phy-names = "usb2-phy\0usb3-phy";
			snps,dis-u2-freeclk-exists-quirk;
			phy_type = "utmi_wide";
			resets = <0x20 0x95>;
			interrupts = <0x00 0xaa 0x04>;
			snps,dis_rxdet_inp3_quirk;
			compatible = "snps,dwc3";
			snps,dis-del-phy-power-chg-quirk;
			status = "okay";
			snps,xhci-trb-ent-quirk;
			snps,parkmode-disable-ss-quirk;
			phys = <0x27 0x23 0x04>;
			reg = <0x00 0xfd000000 0x00 0x400000>;
			dr_mode = "host";
			reset-names = "usb3-host";
			snps,dis-tx-ipgap-linecheck-quirk;
		};
	};

	crypto@fe380000 {
		clock-names = "aclk\0hclk\0sclk\0apb_pclk";
		assigned-clocks = <0x20 0x6c>;
		assigned-clock-rates = <0xbebc200>;
		resets = <0x20 0x69>;
		interrupts = <0x00 0x04 0x04>;
		clocks = <0x20 0x6a 0x20 0x6b 0x20 0x6c 0x20 0x6d>;
		compatible = "rockchip,rk3568-crypto";
		status = "disabled";
		reg = <0x00 0xfe380000 0x00 0x4000>;
		reset-names = "crypto-rst";
	};

	can@fe580000 {
		clock-names = "baudclk\0apb_pclk";
		resets = <0x20 0x157 0x20 0x156>;
		interrupts = <0x00 0x02 0x04>;
		clocks = <0x20 0x143 0x20 0x142>;
		compatible = "rockchip,rk3568-can-2.0";
		status = "disabled";
		tx-fifo-depth = <0x01>;
		rx-fifo-depth = <0x06>;
		reg = <0x00 0xfe580000 0x00 0x1000>;
		reset-names = "can\0can-apb";
	};

	pcie@fe270000 {
		power-domains = <0x22 0x0f>;
		vpcie3v3-supply = <0xad>;
		#address-cells = <0x03>;
		phy-names = "pcie-phy";
		bus-range = <0x10 0x1f>;
		clock-names = "aclk_mst\0aclk_slv\0aclk_dbi\0pclk\0aux";
		reg-names = "pcie-dbi\0pcie-apb";
		num-ob-windows = <0x02>;
		resets = <0x20 0xb1>;
		interrupts = <0x00 0xa0 0x04 0x00 0x9f 0x04 0x00 0x9e 0x04 0x00 0x9d 0x04 0x00 0x9c 0x04>;
		clocks = <0x20 0x88 0x20 0x89 0x20 0x8a 0x20 0x8b 0x20 0x8c>;
		interrupt-map = <0x00 0x00 0x00 0x01 0xaf 0x00 0x00 0x00 0x00 0x02 0xaf 0x01 0x00 0x00 0x00 0x03 0xaf 0x02 0x00 0x00 0x00 0x04 0xaf 0x03>;
		#size-cells = <0x02>;
		max-link-speed = <0x03>;
		device_type = "pci";
		interrupt-map-mask = <0x00 0x00 0x00 0x07>;
		reset-gpios = <0xae 0x03 0x00>;
		num-lanes = <0x01>;
		compatible = "rockchip,rk3568-pcie\0snps,dw-pcie";
		ranges = <0x800 0x00 0xf2000000 0x00 0xf2000000 0x00 0x100000 0x81000000 0x00 0xf2100000 0x00 0xf2100000 0x00 0x100000 0x82000000 0x00 0xf2200000 0x00 0xf2200000 0x00 0x1e00000 0xc3000000 0x03 0x40000000 0x03 0x40000000 0x00 0x40000000>;
		msi-map = <0x1000 0xac 0x1000 0x1000>;
		#interrupt-cells = <0x01>;
		status = "okay";
		rockchip,bifurcation;
		interrupt-names = "sys\0pmc\0msg\0legacy\0err";
		phys = <0xb0>;
		num-viewport = <0x08>;
		reg = <0x03 0xc0400000 0x00 0x400000 0x00 0xfe270000 0x00 0x10000>;
		linux,pci-domain = <0x01>;
		reset-names = "pipe";
		num-ib-windows = <0x06>;

		legacy-interrupt-controller {
			#address-cells = <0x00>;
			interrupts = <0x00 0x9d 0x01>;
			interrupt-parent = <0x01>;
			#interrupt-cells = <0x01>;
			phandle = <0xaf>;
			interrupt-controller;
		};
	};
};
